## drivers/fih/Kconfig
```kconfig
#
# fih driver
#

menu "fih driver"

config FIH_SDM630_SDM660_PROJS
	bool "01 FIH_8937_PROJS"
	help
	Enable the support for FIH_8937_PROJS flag

config FIH_GPIO
	bool "fih gpio"
	default n
	help
	  support fih gpio function

config FIH_INFO
	bool "fih info"
	default y
	help
	  support fih info virtual file

config FIH_MFD
	bool "fih mfd"
	default y
	help
	  support fih mfd virtual file

config FIH_MT_SLEEP
	bool "MT sleep current test feature"
	default n
	help
	  Say Y here to enable support the MT sleep current test

config FIH_NV
	bool "fih nv"
	default y
	help
	  support fih nv virtual file

config FIH_APR
	bool "fih apr"
	default y
	help
	  support fih apr virtual file

config FIH_UFSINFO
	bool "fih ufs info"
	default n
	help
	  support fih ufs info virtual file

config FIH_DDR
	bool "fih ddr"
	default y
	help
	  support fih ddr virtual file

config FIH_SENSOR
	bool "fih sensor"
	default y
	help
	  support fih sensor virtual file

config FIH_SIBEAM_GPIO
	bool "fih SIBEAM"
	default n
	help
	  support fih SIBEAM virtual file

config FIH_MFR
	bool "fih mfr"
	default y
	help
	  support fih modem failure reason virtual file

config FIH_TOUCH
        bool "fih touch"
        default y
        help
          support fih touch virtual file

config FIH_LCM
	bool "fih lcm"
	default y
	help
	  support fih lcm function

config FIH_EMMC
	bool "fih emmc"
	default y
	help
	  support fih emmc function

config FIH_FVER
	bool "fih fver"
	default y
	help
	  support fih fver function

config FIH_USB
	bool "fih usb"
	default y
	help
	  support fih emmc function

config FIH_HWCONFIG
	bool "fih hwcfg/swid/hwid"
	default y
	help
	  support fih hwcfg/swid/hwid function

config FIH_DEVICE_TREE_DEBUG
	bool "FIH Device Tree Debug"
	default y

config FIH_HALL_SENSOR
	bool "FIH Hall sensor"
	default y

config FIH_CPU_USAGE
	bool "FIH cpu usage information"
	default y
	help
	  support fih cpu usage information
endmenu

#Kernel Module sign key from FIH
config MODULE_SIG_FIH
	bool "Use static module sign key"
	depends on MODULE_SIG
	help
	  Use the static module sign key
	  in kernel/cert/fih/

choice
	prompt "Define fih sig key path"
	depends on MODULE_SIG_FIH
	default MODULE_SIG_KEY_IN_NORMAL
	help
	  fih sig key path

config MODULE_SIG_KEY_IN_NORMAL
	bool "Key for normal"

config MODULE_SIG_KEY_IN_FTM
	bool "Key for normal"

endchoice

config MODULE_SIG_FIH_KEY_PATH
	string
	depends on MODULE_SIG_FIH
	default "${KBUILD_SRC}/certs/fih" if MODULE_SIG_KEY_IN_NORMAL
	default "../../../mach/QCOM8937/kernel/linux/certs/fih" if MODULE_SIG_KEY_IN_FTM
```

## drivers/haptics/Kconfig
```kconfig
config HAPTICS_DRV2605
	tristate "TI DRV2605 haptic driver"
	depends on I2C && SYSFS
	help
	  If you say yes here you get support for the TI DRV2605
	  haptic driver.
```

## drivers/input/fingerprint/elan/Kconfig
```kconfig
#
# Configuration for ELAN
#

config ELAN_614R
	bool "ELAN 614R Driver" 
	default n
	---help---
	  This is a ELAN 614R chipset Driver.
```

## drivers/input/fingerprint/goodix_gf5288/Kconfig
```kconfig
#
# Configuration for Goodix GF5288
#
config INPUT_GF5288
	bool "Goodix GF5288 Driver"
	default n
	help
	  This is a Goodix GF5288 chipset Driver.
```

## drivers/input/touchscreen/gt1x/Kconfig
```kconfig
#
# Goodix Touchscreen driver configuration
#

config TOUCHSCREEN_GX
        bool "Goodix Touchscreen"
		depends on I2C
		default n
		help
		  Say Y here if you have Goodix touch panel.
		  If unsure, say N.

config TOUCHSCREEN_GX_DIRECTORY
    string "Goodix ts directory name"
    default "gt1x"
    depends on TOUCHSCREEN_GX
    
```

## drivers/input/touchscreen/ilitek/Kconfig
```kconfig
#
# ILITEK I2C Touchscreen driver
#

config TOUCHSCREEN_ILI210X
	tristate "ILITEK I2C touchscreen driver for linux platform"
	default n
	help
	  This is the main file for touchpanel driver for ILITEK I2C
	  touchscreens.

	  Say Y here if you have a ILITEK I2C touchscreen connected
	  to your system.

	  If unsure, say N.

	  To compile this driver as a module, choose M here: the
	  module will be called gt9xx.
```

## drivers/video/boost/Kconfig
```kconfig
#
# Boost drivers configuration
#

menuconfig BOOST_CONVERTER_SUPPORT
	bool "Boost Converter support"
	help
	  Enable this to be able to choose the drivers for controlling the
	  boost converter on some platforms, for example on PDAs.

if BOOST_CONVERTER_SUPPORT

config BOOST_FP7720
	tristate "Boost Driver for FP7720"
	depends on I2C
	select REGMAP_I2C
	help
		This supports Fiti Power 7720BE9 Boost Converter

config BOOST_NT50356
	tristate "Boost and WLED Driver for BOOST_NT50356"
	depends on I2C
	select REGMAP_I2C
	help
		This supports NOVATEK BOOST_NT50356 Boost Converter and WLED driver

endif # BOOST_CONVERTER_SUPPORT
```

## drivers/video/fbdev/msm/fih/Kconfig
```kconfig
#
# FIH Panel Feature
#

config FIH_PANEL_FEATURE
	bool "FIH Panel feature support"
	depends on ARM || ARM64
	---help---
	  Support for FIH display feature 

config AOD_FEATURE
	bool "Always on display feature support"
	depends on FIH_PANEL_FEATURE
	---help---
	  Support for Always on display 

config PANEL_POWER_CONTROL_FEATURE
	bool "Display power control support"
	depends on FIH_PANEL_FEATURE
	---help---
	  Support for display power control
```

## sound/soc/codecs/tas2560/Kconfig
```kconfig
menuconfig SND_SOC_TAS2560
	tristate "Texas Instruments TAS2560 SmartAmp(R)"

if SND_SOC_TAS2560
config TAS2560_REGMAP
    bool "Use of RegMap API"

config TAS2560_CODEC
    bool "Codec Driver support"

config TAS2560_MISC
    bool "Misc Driver support"

#config TAS2560_HAPTICS
#	bool "Haptics Driver"

endif # SND_SOC_TAS2560
```
