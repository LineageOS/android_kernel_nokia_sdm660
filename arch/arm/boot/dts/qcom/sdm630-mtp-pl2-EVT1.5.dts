/* Copyright (c) 2017, The Linux Foundation. All rights reserved.
 *
 * This program is free software; you can redistribute it and/or modify
 * it under the terms of the GNU General Public License version 2 and
 * only version 2 as published by the Free Software Foundation.
 *
 * This program is distributed in the hope that it will be useful,
 * but WITHOUT ANY WARRANTY; without even the implied warranty of
 * MERCHANTABILITY or FITNESS FOR A PARTICULAR PURPOSE.  See the
 * GNU General Public License for more details.
 */


/dts-v1/;

#include "sdm630-pl2.dtsi"
#include "sdm630-mtp.dtsi"
#include "sdm660-internal-codec-pl2.dtsi"
#include "fih/nokia/pl2-preEVT-630.dtsi"
/ {
	model = "Qualcomm Technologies, Inc. SDM 630 PM660 + PM660L MTP, PL2 EVT 1.5";
	compatible = "qcom,sdm630-mtp", "qcom,sdm630", "qcom,mtp";
	qcom,board-id = <8 0>;
	qcom,pmic-id = <0x0001001b 0x0101011a 0x0 0x0>,
			<0x0001001b 0x0201011a 0x0 0x0>;
	fih,hw-id = <3 1 2>;
};

&i2c_6 {
	status = "okay";
	nq@28 {
		status = "disabled";
	};
	sec-nfc@27{
		status = "disabled";
	};
};
