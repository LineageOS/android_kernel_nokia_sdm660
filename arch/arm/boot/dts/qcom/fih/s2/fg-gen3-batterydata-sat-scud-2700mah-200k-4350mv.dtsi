qcom,sat_scud_2700mah_200k_4350mv {
	qcom, = <24>;
	/* #3429176_FIH_SAT630scud_2700mAh_averaged_MasterSlave_May25th2018*/
	qcom,max-voltage-uv = <4350000>;		/* 4.35V */
	qcom,fg-cc-cv-threshold-mv = <4340>;
	qcom,nom-batt-capacity-mah = <2700>;
	qcom,fastchg-current-ma = <2100>;		/* 0.7C */
	qcom,batt-id-kohm = <200>;
	qcom,battery-beta = <3435>;
	qcom,battery-type = "sat_scud_2700mah_200k_4350mv";
	qcom,checksum = <0x24E5>;
	qcom,gui-version = "PM660GUI - 0.0.0.45";
	qcom,fg-profile-data = [
		 38 1E 66 07
		 DB 01 E6 D4
		 E4 1C F6 01
		 A2 0D CE 0A
		 C3 17 0D 2A
		 F1 4D D4 5A
		 63 00 00 00
		 0F 00 00 00
		 00 00 C0 C4
		 AC C5 6F C2
		 21 00 08 00
		 7B DB 8A E4
		 83 FD AD 00
		 42 01 EC 12
		 BF F5 A9 23
		 1C 06 09 20
		 27 00 14 00
		 3D 1F AD FC
		 7D 03 23 07
		 CC 1C D8 02
		 33 0C 10 12
		 80 18 00 2A
		 B9 4D 96 5B
		 68 00 00 00
		 0D 00 00 00
		 00 00 D5 D5
		 34 C3 4B CA
		 1B 00 00 00
		 99 EA 8A E4
		 75 F4 83 EB
		 87 EA 93 0A
		 B3 CB CD 1A
		 A4 33 CC FF
		 07 10 00 00
		 FD 0A 66 46
		 1B 00 40 00
		 BE 01 0A FA
		 FF 00 00 00
		 00 00 00 00
		 00 00 00 00
		 00 00 00 00
		 00 00 00 00
		 00 00 00 00
		 00 00 00 00
		 00 00 00 00
		 00 00 00 00
		 00 00 00 00
		 00 00 00 00
		 00 00 00 00
		 00 00 00 00
		 00 00 00 00
		 00 00 00 00
		 00 00 00 00
		 00 00 00 00
		 00 00 00 00
		 00 00 00 00
	];
};
