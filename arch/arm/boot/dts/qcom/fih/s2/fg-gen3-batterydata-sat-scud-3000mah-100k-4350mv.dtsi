qcom,sat_scud_3000mah_100k_4350mv {
	qcom, = <24>;
	/* #3357863_FIH_SAT630ebt_2960mAh_averaged_MasterSlave_Mar27th2018*/
	qcom,max-voltage-uv = <4350000>;		/* 4.35V */
	qcom,fg-cc-cv-threshold-mv = <4340>;
	qcom,nom-batt-capacity-mah = <2960>;
	qcom,fastchg-current-ma = <2100>;		/* 0.7C */
	qcom,batt-id-kohm = <100>;
	qcom,battery-beta = <3435>;
	qcom,battery-type = "sat_scud_3000mah_100k_4350mv";
	qcom,checksum = <0x08F2>;
	qcom,gui-version = "PM660GUI - 0.0.0.45";
	qcom,fg-profile-data = [
		 F7 1E 65 06
		 84 03 18 07
		 CC 1C 18 02
		 8D 0D BE 0A
		 09 18 D1 23
		 2E 44 9F 5A
		 70 00 00 00
		 0F 00 00 00
		 00 00 8F C3
		 A3 CC 41 AA
		 4C 00 08 00
		 5E CB 8D DC
		 79 04 46 02
		 22 0D 65 F5
		 FB EC 18 2A
		 43 06 09 20
		 27 00 14 00
		 CC 1F 9D 05
		 64 0A 6C 06
		 CD 1C F1 02
		 13 0C 1A 12
		 88 18 10 2A
		 90 4D FC 5B
		 6C 00 00 00
		 0D 00 00 00
		 00 00 17 D5
		 B7 C3 A6 CB
		 25 00 00 00
		 09 E3 8D DC
		 3B 06 65 F3
		 BD E3 10 0A
		 DC E3 10 23
		 B7 33 CC FF
		 07 10 00 00
		 D4 0B 66 46
		 25 00 40 00
		 D5 01 0A FA
		 FF 00 00 00
		 00 00 00 00
		 00 00 00 00
		 00 00 00 00
		 00 00 00 00
		 00 00 00 00
		 00 00 00 00
		 00 00 00 00
		 00 00 00 00
		 00 00 00 00
		 00 00 00 00
		 00 00 00 00
		 00 00 00 00
		 00 00 00 00
		 00 00 00 00
		 00 00 00 00
		 00 00 00 00
		 00 00 00 00
		 00 00 00 00
	];
};
