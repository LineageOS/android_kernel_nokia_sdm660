qcom,C1N_3000mah_68k {
	qcom, = <24>;
	/* #2854679_FIH_SAT660_3000mAh_averaged_MasterSlave_Apr19th2017*/
	qcom,max-voltage-uv = <4400000>;
	qcom,fg-cc-cv-threshold-mv = <4390>;
	qcom,nom-batt-capacity-mah = <3000>;
	qcom,fastchg-current-ma = <3000>;
	qcom,batt-id-kohm = <68>;
	qcom,battery-beta = <3435>;
	qcom,battery-type = "C1N_coslight_3000mah_68k";
	qcom,checksum = <0xB110>;
	qcom,gui-version = "PM660GUI - 0.0.0.36";
	qcom,fg-profile-data = [
		 6C 1F B0 05
		 72 0A 9F FC
		 7B 1D 53 F4
		 90 12 D9 1D
		 01 18 0C 23
		 B0 45 62 52
		 56 00 00 00
		 10 00 00 00
		 00 00 89 BB
		 E4 CD 98 BD
		 24 00 08 00
		 23 EA 11 ED
		 72 05 61 FB
		 FF 0C 97 0A
		 72 07 9E 32
		 29 06 09 20
		 27 00 14 00
		 D0 1F 87 05
		 7F 0A 4E 06
		 68 1D 32 00
		 0F 0B C3 14
		 56 19 D0 22
		 7E 45 05 53
		 55 00 00 00
		 0E 00 00 00
		 00 00 3A CC
		 EC BA 7C AB
		 1A 00 00 00
		 BE EB 11 ED
		 6B 06 CB F3
		 C5 FC E7 F2
		 9C 02 F0 22
		 C6 33 CC FF
		 07 10 00 00
		 14 0C 66 46
		 1A 00 40 00
		 97 01 0A FA
		 FF 00 00 00
		 00 00 00 00
		 00 00 00 00
		 00 00 00 00
		 00 00 00 00
		 00 00 00 00
		 00 00 00 00
		 00 00 00 00
		 00 00 00 00
		 00 00 00 00
		 00 00 00 00
		 00 00 00 00
		 00 00 00 00
		 00 00 00 00
		 00 00 00 00
		 00 00 00 00
		 00 00 00 00
		 00 00 00 00
		 00 00 00 00
	];
};
