
qcom,3032235_fih_he347scud_3700mah_averaged_masterslave_sept29th2017 {
	qcom, = <24>;
	/* #3032235_FIH_HE347scud_3700mAh_averaged_MasterSlave_Sept29th2017*/
	qcom,max-voltage-uv = <4400000>;
	qcom,fg-cc-cv-threshold-mv = <4390>;
	qcom,nom-batt-capacity-mah = <3700>;
	qcom,fastchg-current-ma = <3400>;
	qcom,batt-id-kohm = <200>;
	qcom,battery-beta = <3435>;
	qcom,battery-type = "B2N_coslight_3700mah_200k";
	qcom,checksum = <0x6F9C>;
	qcom,gui-version = "PM660GUI - 0.0.0.44";
	qcom,fg-profile-data = [
		 59 1F D7 05
		 45 0A 07 FD
		 79 1D 3E 07
		 55 12 0B 14
		 70 18 03 23
		 8B 45 B8 52
		 56 00 00 00
		 0F 00 00 00
		 00 00 E8 C4
		 2C CD 2A CB
		 1E 00 08 00
		 50 D3 E9 07
		 1E 05 DF 01
		 B1 02 09 1B
		 AF F5 53 32
		 24 06 09 20
		 27 00 14 00
		 9A 1F DB 05
		 21 0A C2 06
		 62 1D 54 EA
		 BE 0A 04 15
		 44 19 CA 22
		 94 45 D6 52
		 55 00 00 00
		 0E 00 00 00
		 00 00 CF D5
		 6F BB 17 CA
		 17 00 00 00
		 0C E2 E9 07
		 DA 05 8D FA
		 31 FD 00 03
		 B4 01 E6 22
		 C5 33 CC FF
		 07 10 00 00
		 F7 0E 66 46
		 17 00 40 00
		 C3 01 0A FA
		 FF 00 00 00
		 00 00 00 00
		 00 00 00 00
		 00 00 00 00
		 00 00 00 00
		 00 00 00 00
		 00 00 00 00
		 00 00 00 00
		 00 00 00 00
		 00 00 00 00
		 00 00 00 00
		 00 00 00 00
		 00 00 00 00
		 00 00 00 00
		 00 00 00 00
		 00 00 00 00
		 00 00 00 00
		 00 00 00 00
		 00 00 00 00
	];
};
