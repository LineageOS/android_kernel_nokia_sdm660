/*Fullchip

//dtype, last, wait, ip, opt, dlen
//sys*/
&fih_dsi_ctl_ctc_jd9522z_fhd_video {

  mdss_iris_cfg_ctl_ctc_zd9522z_fhd_video: pxlw,mdss_iris_cfg_ctl_ctc_jd9522z_fhd_video {
  pxlw,panel-type = "PANEL_LCD_P3";
  pxlw,panel-dimming-brightness = <4095>;
  //pxlw,dynamic-power;
  pxlw,pkt-payload-size = <52>;
  pxlw,last-for-per-pkt = <4>;
  pxlw,cont-last-for-per-pkt = <8>;
  pxlw,pt-last-for-per-pkt = <12>;
  pxlw,add-vblank-line = <1>;
  pxlw,lut-mode = "single";
  pxlw,iris-lightup-sequence-pre0 = [
    /*sys*/
    00  a0  00
    00  a1  00
    00  a2  00
    00  a3  00
    00  a4  00
    00  a5  00
    00  a6  00
  ];


  pxlw,iris-lightup-sequence-pre1 = [
    /*sys*/
    00  b0  00
    00  b1  00
    00  b2  00
    00  b3  00
    00  b4  00
    00  b5  00
    00  b6  00
  ];
  pxlw,iris-lightup-sequence-cont-splash = [
    /*sys*/
    00  00  00
    00  e0  00
    /* rx ctrl */
    01  f0  00
    /*tx*/
    02  01  00
    02  00  00
    02  e0  00
    /*dtg*/
    05  00  00
    05  e0  00
    /*dport*/
    04  fa  00
    04  8a  00
    /*pwil*/
    03  fa  00
    03  8a  00
    /* dsc decoder */
    07  fa  00
    07  8a  00
    /* dsc encoder */
    08  fa  00
    08  8a  00
    /*peaking*/
    0c  fa  00
    /*dpp*/
    0e  fa  00
    /*cm*/
    0a  fa  00
  ];
  pxlw,iris-lightup-sequence = [
    /*sys*/
    00  00  00
    00  e0  00
    /* rx ctrl */
    01  f0  00
    /*tx*/
    02  01  00
    02  00  00
    02  e0  00
    /*dtg*/
    05  00  00
    05  e0  00
    /* blc_pwm */
    06  f0  00
    06  00  00
    /* hdr */
    09  11  00
    /*lut*/
    10  41  00
    10  44  00
    10  47  00
    10  4a  00
    10  20  00
    10  21  00
    10  64  00
    10  a0  00
    10  c0  00
    10  80  00
    10  e0  00
    09  fe  00
    0f  fe  00
    0e  fe  00
    /*DMA */
    11  f1 00
    /*dport*/
    04  f0  00
    04  80  00
    /*pwil*/
    03  f0  00
    03  f1  00
    03  f3  00
    03  80  00
    /*peaking*/
    0c  f0  00
    0c  a0  00
    0c  80  00
    /*dpp*/
    0e  f0  00
    0e  a0  00
    0e  80  00
    /*hdr*/
    09  a0  00
    09  70  00
    09  80  00
    /**cm*/
    0a  f0  00
    0a  a0  00
    0a  80  00
    /*lce*/
    0d  f0  00
    0d  a0  00
    0d  80  00
    0d  70  00
    0d  71  00
    /* scaler1d */
    0b  f0  00
    0b  a0  00
    /* dbc */
    0f  f0  00
    0f  a0  00
    0f  70  00
    /* dsc decoder */
    07  f0  00
    07  a0  00
    07  80  00
    /* dsc encoder */
    08  f0  00
    08  a0  00
    08  80  00
    /* pq configure */
    /* peaking */
    0c  00  00
    0c  e0  00
    0c  11  00
    /* cm */
    0a  00  00
    0a  10  00
    0a  b0  00
    0a  b1  00
    0a  b2  00
    0a  b3  00
    0a  b4  00
    0a  b5  00
    0a  40  00
    0a  e0  00
    0a  fd  00
    0a  fc  00
    0a  fb  00
    /* lce */
    0d  00  00
    0d  10  00
    0d  e0  00
    0d  fd  00
    /* dbc */
    0f  00  00
    0f  fc  00
    /* dpp */
    0e  40  00
    /* pwil */
    03  fd  00
    03  e0  00
    03  61  00
    03  93  00
    03  51  00
    /*hdr*/
    09  00  00
    09  e0  00
    /*DMA*/
    11  e1  00
    /* manual power */
    00  fc  00
    /* dynamic power */
    00  f1  00
  ];


  pxlw,iris-pq-default-val = [
    /* peaking */
    0c  00
    0c  e0
    0c  11
    /* cm */
    0a  00
    0a  10
    0a  40
    0a  e0
    0a  fd
    0a  fc
    0a  fb
    /* lce */
    0d  00
    0d  10
    0d  e0
    0d  fd
    /* dbc */
    0f  00
    0f  fc
    /* dpp */
    0e  40
    /* pwil */
    03  fd
    03  e0
    03  61
    03  93
    /*hdr*/
    09  00
    09  e0
    /*blc_pwm*/
    06  00
    /* lut */
    10  41
    10  44
    10  47
    10  4a
    10  64
    10  a0
    10  c0
    10  21
    10  e0
    0f  fe
    09  fe
    0e  fe
    /*DMA */
    11  f1
    /*SYS*/
    00  f1
    00  e0
    /*MIPI_TX*/
    02  e0
    /*DTG*/
    05  e0
  ];


  pxlw,iris-cmd-list =
  <
    // version: v1.07 build: 07-16-2018 14:58
    // mipi_rx: dphy
    0x29 0x01 0x00 0x01 0x01F1 0x13 0xFFFFFFF4
                                    0xF0040008 0x005C0280 0xF0040808 0x10020200 0xF0040910 0x0000000C
                                    0xF0040A00 0x00000060 0xF0040A04 0x0002004E 0xF0040A10 0x0002004E
                                    0xF0040A18 0x0002004E 0xF0040A20 0x0002004E 0xF0040A28 0x0016004E

    // mipi_rx: ctrl
    0x29 0x01 0x00 0x01 0x00F0 0x11 0xFFFFFFF4
                                    0xF0040238 0x00770000 0xF0040300 0x04370000 0xF0040304 0x08E70000
                                    0xF0041804 0x000008E8 0xF0040104 0x00000000 0xF0040144 0x0010021C
                                    0xF0040148 0x0000021C 0xF0040080 0x00000000

    // sys: a0: init 0
    0x29 0x01 0x01 0x00 0x00A0 0x05 0xFFFFFFF4
                                    0xF0000004 0x0002820F 0xF0000000 0x000000F9

    // sys: a0: init 1
    0x29 0x01 0x1E 0x00 0x00A1 0x03 0xFFFFFFF4
                                    0xF0000000 0x000000F0

    // sys: a0: init 2
    0x29 0x01 0x02 0x00 0x00A2 0x0D 0xFFFFFFF4
                                    0xF0000000 0x00000000 0xF0000034 0x00A1582D 0xF0000064 0x0000060B
                                    0xF0000018 0x00128227 0xF0000014 0x000000F1 0xF0000014 0x000000F8

    // sys: a0: init 3
    0x29 0x01 0x1E 0x00 0x00A3 0x03 0xFFFFFFF4
                                    0xF0000014 0x000000F0

    // sys: a0: init 4
    0x29 0x01 0x00 0x00 0x00A4 0x03 0xFFFFFFF4
                                    0xF0000014 0x00000000

    // sys: a0: init 5
    0x29 0x01 0x00 0x00 0x00A5 0x0D 0xFFFFFFF4
                                    0xF0000034 0x00A15C2D 0xF000001C 0x01E3C013 0xF0000014 0x00000001
                                    0xF0000014 0x00000000 0xF000001C 0x01E3C813 0xF000001C 0x01E3C013

    // sys: a0: init 6
    0x29 0x01 0x00 0x00 0x00A6 0x07 0xFFFFFFF4
                                    0xF0000034 0x00587C1D 0xF0000064 0x00000000 0xF0000000 0x000000FC

    // sys: a1: init 0
    0x29 0x01 0x01 0x00 0x00B0 0x05 0xFFFFFFF4
                                    0xF0000004 0x0002820F 0xF0000000 0x000000F9

    // sys: a1: init 1
    0x29 0x01 0x1E 0x00 0x00B1 0x03 0xFFFFFFF4
                                    0xF0000000 0x000000F0

    // sys: a1: init 2
    0x29 0x01 0x02 0x00 0x00B2 0x0D 0xFFFFFFF4
                                    0xF0000000 0x00000000 0xF0000034 0x00A1582D 0xF0000064 0x0000060B
                                    0xF0000018 0x000A901B 0xF0000014 0x000000F1 0xF0000014 0x000000F8

    // sys: a1: init 3
    0x29 0x01 0x1E 0x00 0x00B3 0x03 0xFFFFFFF4
                                    0xF0000014 0x000000F0

    // sys: a1: init 4
    0x29 0x01 0x00 0x00 0x00B4 0x03 0xFFFFFFF4
                                    0xF0000014 0x00020000

    // sys: a1: init 5
    0x29 0x01 0x00 0x00 0x00B5 0x0D 0xFFFFFFF4
                                    0xF0000034 0x00A15C2D 0xF000001C 0x01E0F014 0xF0000014 0x00020001
                                    0xF0000014 0x00020000 0xF000001C 0x01E0F814 0xF000001C 0x01E0F014

    // sys: a1: init 6
    0x29 0x01 0x00 0x00 0x00B6 0x07 0xFFFFFFF4
                                    0xF0000034 0x00A3781D 0xF0000064 0x00000000 0xF0000000 0x000200FC

    // sys: misc
    0x29 0x01 0x00 0x00 0x0000 0x09 0xFFFFFFF4
                                    0xF0000028 0x00000008 0xF0000044 0x00000027 0xF0000048 0x00008180
                                    0xF000004C 0x0000D400

    // sys: lp: te_dly
    0x29 0x01 0x00 0x00 0x00E0 0x07 0xFFFFFFF4
                                    0xF0000048 0x00008180 0xF000004C 0x0000D400 0xF0000074 0x5C00000D

    // sys: lp: evs_dly
    0x29 0x01 0x00 0x00 0x00E1 0x07 0xFFFFFFF4
                                    0xF0000048 0x02008180 0xF000004C 0x00005400 0xF0000074 0x5C00004A

    // sys: lp: v0p85
    0x29 0x01 0x00 0x00 0x0003 0x03 0xFFFFFFF4
                                    0xF0010004 0x000000A0

    // sys: abyp: enter
    0x29 0x01 0x00 0x00 0x0104 0x05 0xFFFFFFF4
                                    0xF0000068 0x00000002 0xF0000068 0x00000000

    // sys: abyp: exit
    0x29 0x01 0x00 0x00 0x0105 0x05 0xFFFFFFF4
                                    0xF0000068 0x00000001 0xF0000068 0x00000000

    // dtg: init
    0x29 0x01 0x00 0x05 0x0000 0x1D 0xFFFFFFF4
                                    0xF0200000 0x00000054 0xF0200004 0x0000000C 0xF0200008 0x00000438
                                    0xF020000C 0x00000070 0xF0200010 0x00000002 0xF0200014 0x00000010
                                    0xF0200018 0x000008E8 0xF020001C 0x00000014 0xF0200020 0x00000023
                                    0xF0200024 0x00001187 0xF0200028 0x00000000 0xF020002C 0x00000008
                                    0xF0200030 0x00000000 0xF0210000 0x00000001

    // dtg: lp: te_dly
    0x29 0x01 0x00 0x05 0x00E0 0x07 0xFFFFFFF4
                                    0xF0200028 0x00000000 0xF0200030 0x0000000A 0xF0210000 0x00000001

    // dtg: lp: evs_dly
    0x29 0x01 0x00 0x05 0x00E1 0x07 0xFFFFFFF4
                                    0xF0200028 0x000008BA 0xF0200030 0x00000000 0xF0210000 0x00000001

    // mipi_tx: init
    0x29 0x01 0x00 0x02 0x0000 0x1D 0xFFFFFFF4
                                    0xF0C00050 0x0F010007 0xF0C00054 0x0E090F06 0xF0C00058 0x0E092306
                                    0xF0C00004 0x00000201 0xF0C00018 0x034E0102 0xF0C00024 0x0088B800
                                    0xF0C00028 0x00FFFF17 0xF0C0002C 0x0A8C0780 0xF0C00030 0x000160C6
                                    0xF0C00044 0x0000C018 0xF0C00010 0x0010021C 0xF0C00014 0x0000021C
                                    0xF0C00008 0x00000011 0xF0C00000 0x0200C039

    // mipi_tx: dphy
    0x29 0x01 0x00 0x02 0x0001 0x07 0xFFFFFFF4
                                    0xF0D00200 0x00000060 0xF0D00004 0x00410304 0xF0D0001C 0x0000000C

    // mipi_tx: pre init
    0x29 0x01 0xF0 0x02 0x0104 0x05 0xFFFFFFF4
                                    0xF0C00004 0x00000001 0xF0C00000 0x0200C039

    // mipi_tx: lp: te_dly
    0x29 0x01 0x00 0x02 0x00E0 0x03 0xFFFFFFF4
                                    0xF0C00018 0x034E0102

    // mipi_tx: lp: evs_dly
    0x29 0x01 0x00 0x02 0x00E1 0x03 0xFFFFFFF4
                                    0xF0C00018 0x034E0100

    // dport: init
    0x29 0x01 0x00 0x04 0x00F0 0x009 0x0001000C 0xF0030F74
                                    0xE0004007 0x21000803 0x48E80438 0x06000800 0x06081802 0x00040100
                                    0x00000000

    // dport: update
    0x29 0x01 0x00 0x04 0x0080 0x003 0x0001000C 0xF0030F90
                                    0x00000001

    // hdr: 0
    0x29 0x01 0x00 0x09 0x0000 0x5E 0x0001000C 0xF00309D0
                                    0x0000016D 0x0FFF0000 0x0FFF0000 0x04E80273 0x0000075C 0x099804CB
                                    0x00000E65 0x0FFF082E 0x0FFF082E 0x099904CC 0x00000E66 0x00140A02
                                    0x00000000 0x000000C8 0x00002828 0x00002828 0x02220028 0x02220028
                                    0x043808E8 0x0000006D 0x00000100 0x00000020 0x00000000 0x092C030D
                                    0x0FFF0DC4 0x1E061E06 0x1E061E06 0x00000008 0x018C0049 0x0000001E
                                    0x01750000 0x000E0151 0x00000002 0x00000000 0x00000000 0x00000000
                                    0x00000009 0x056D7E29 0x7FD77E8F 0x02000079 0x021A0200 0x00007F71
                                    0x00000000 0x00000000 0x00000000 0x00000000 0x00000000 0x00000000
                                    0x00000000 0x00000000 0x00000000 0x00000000 0x00000000 0x00000000
                                    0x00000000 0x00000000 0x00000000 0x00000000 0x00000000 0x00000000
                                    0x00000000 0x00000000 0x00000000 0x00000000 0x00000000 0x00000000
                                    0x00000000 0x00000000 0x00000000 0x00000000 0x00000000 0x00000000
                                    0x0015EB43 0x002FAED1 0x000FB947 0x00408040 0x00000000 0x00000003
                                    0x1D0E3617 0x00140000 0x0007FFFF 0x00140000 0x00040000 0x00000000
                                    0x00000000 0x00000000 0x00000000 0x00000000 0x00000000 0x07940708
                                    0x00000000 0x01100001

    // hdr: 1
    0x29 0x01 0x00 0x09 0x0001 0x5E 0x0001000C 0xF00309D0
                                    0x0000006D 0x0FFF0000 0x0FFF0000 0x04E80273 0x0000075C 0x099804CB
                                    0x00000E65 0x0FFF082E 0x0FFF082E 0x099904CC 0x00000E66 0x00140A02
                                    0x00000000 0x000000C8 0x00002828 0x00002828 0x02220028 0x02220028
                                    0x043808E8 0x0000006D 0x00000100 0x00000020 0x00000000 0x092C030D
                                    0x0FFF0DC4 0x1E061E06 0x1E061E06 0x00000008 0x05C30431 0x0083009B
                                    0x073400E7 0x0155034C 0x00000031 0x00000000 0x00000000 0x00000000
                                    0x00000009 0x04005E09 0x7EF06569 0x0DAD0000 0x04002307 0x00000CE9
                                    0x00000000 0x00000000 0x00000000 0x0000000E 0x08000800 0x00120800
                                    0x047B7FEF 0x7F1D00E3 0x00007D6F 0x00000000 0x00000000 0x00000000
                                    0x00000008 0x0FDE6BF2 0x008F7F35 0x09007E76 0x79AC1B7F 0x00007FCB
                                    0x00000000 0x00000000 0x00000000 0x00000008 0x124D7397 0x7EEA7646
                                    0x0D7F019A 0x07170D7F 0x00007C3B 0x00001000 0x00000000 0x00001000
                                    0x0051C44A 0x00AF9FE0 0x00173C20 0x00408040 0x00000000 0x00000003
                                    0x00003613 0x00140000 0x0007FFFF 0x00140000 0x00040FFF 0x00000000
                                    0x04000000 0x0403FFFF 0x0403FFFF 0x3FFC0000 0x3FFC0000 0x07940708
                                    0x00000000 0x01100001

    // hdr: 2
    0x29 0x01 0x00 0x09 0x0002 0x5E 0x0001000C 0xF00309D0
                                    0x0000006D 0x0FFF0000 0x0FFF0000 0x04E80273 0x0000075C 0x099804CB
                                    0x00000E65 0x0FFF082E 0x0FFF082E 0x099904CC 0x00000E66 0x00140A02
                                    0x00000000 0x000000C8 0x00002828 0x00002828 0x02220028 0x02220028
                                    0x043808E8 0x0000006D 0x00000100 0x00000020 0x00000000 0x092C030D
                                    0x0FFF0DC4 0x1E061E06 0x1E061E06 0x00000008 0x018C0049 0x0000001E
                                    0x01750000 0x000E0151 0x00000002 0x00000000 0x00000000 0x00000000
                                    0x00000009 0x056D7C52 0x7FAE7D1E 0x04000079 0x021A0400 0x00007EE2
                                    0x00000000 0x00000000 0x00000000 0x00000000 0x00000000 0x00000000
                                    0x00000000 0x00000000 0x00000000 0x00000000 0x00000000 0x00000000
                                    0x00000000 0x00000000 0x00000000 0x00000000 0x00000000 0x00000000
                                    0x00000000 0x00000000 0x00000000 0x0000000C 0x08000800 0x00000800
                                    0x0F0D7EAF 0x7B6E0Bcc 0x00000000 0x00000000 0x00000000 0x00000000
                                    0x0015EB43 0x002FAED1 0x000FB947 0x00408040 0x00000000 0x00000003
                                    0x0D0E3617 0x00140000 0x0007FFFF 0x00140000 0x00040000 0x00000000
                                    0x00000000 0x00000000 0x00000000 0x00000000 0x00000000 0x07940708
                                    0x00000000 0x01100001

    // hdr: 3
    0x29 0x01 0x00 0x09 0x0003 0x5E 0x0001000C 0xF00309D0
                                    0x0000006D 0x0FFF0000 0x0FFF0000 0x04E80273 0x0000075C 0x099804CB
                                    0x00000E65 0x0FFF082E 0x0FFF082E 0x099904CC 0x00000E66 0x00140A02
                                    0x00000000 0x000000C8 0x00002828 0x00002828 0x02220028 0x02220028
                                    0x043808E8 0x0000006D 0x00000100 0x00000020 0x00000000 0x092C030D
                                    0x0FFF0DC4 0x1E061E06 0x1E061E06 0x00000008 0x0FDE6BF2 0x008F7F35
                                    0x09007E76 0x79AC1B7F 0x00007FCB 0x00000000 0x00000000 0x00000000
                                    0x00000009 0x056D7C52 0x7FAE7D1E 0x04000079 0x021A0400 0x00007EF2
                                    0x00000000 0x00000000 0x00000000 0x00000000 0x00000000 0x00000000
                                    0x00000000 0x00000000 0x00000000 0x00000000 0x00000000 0x00000000
                                    0x00000000 0x00000000 0x00000000 0x00000000 0x00000000 0x00000000
                                    0x00000000 0x00000000 0x00000000 0x00000000 0x00000000 0x00000000
                                    0x00000000 0x00000000 0x00000000 0x00000000 0x00000000 0x00000000
                                    0x0047D143 0x00B9AEEB 0x000F2F15 0x00408040 0x00000000 0x00000003
                                    0x1C0C3617 0x00140000 0x0007FFFF 0x00140000 0x00000000 0x00000000
                                    0x00000000 0x0003FFFF 0x0003FFFF 0x00000000 0x00000000 0x07940708
                                    0x00000000 0x01100001

    // hdr: 4
    0x29 0x01 0x00 0x09 0x0004 0x5E 0x0001000C 0xF00309D0
                                    0x00003068 0x0FFF0000 0x0FFF0000 0x04E80273 0x0000075C 0x099804CB
                                    0x00000E65 0x0FFF082E 0x0FFF082E 0x099904CC 0x00000E66 0x00140A02
                                    0x00000000 0x000000C8 0x00002828 0x00002828 0x02220028 0x02220028
                                    0x043808E8 0x0000006D 0x00000082 0x00000020 0x00000000 0x092C030D
                                    0x0FFF0DC4 0x1E061E06 0x1E061E06 0x00000008 0x018C0049 0x0000001E
                                    0x01750000 0x000E0151 0x00000002 0x00000000 0x00000000 0x00000000
                                    0x00000009 0x04B27CA7 0x7F597D5A 0x040000E9 0x02640400 0x00007EA6
                                    0x00000000 0x00000000 0x00000000 0x00000000 0x00000000 0x00000000
                                    0x00000000 0x00000000 0x00000000 0x00000000 0x00000000 0x00000000
                                    0x00000000 0x00000000 0x00000000 0x00000000 0x00000000 0x00000000
                                    0x00000000 0x00000000 0x00000000 0x00000000 0x00000000 0x00000000
                                    0x00000000 0x00000000 0x00000000 0x00000000 0x00000000 0x00000000
                                    0x0020E04A 0x003C9FC4 0x0017AF51 0x00408040 0x00000000 0x00000000
                                    0x1C1C044C 0x00140000 0x0007FFFF 0x00140000 0x00040000 0x00000000
                                    0x00000000 0x0003FFFF 0x0003FFFF 0x00000000 0x00000000 0x07940708
                                    0x00000000 0x01100001

    // hdr: 5
    0x29 0x01 0x00 0x09 0x0005 0x5E 0x0001000C 0xF00309D0
                                    0x00001028 0x0FFF0000 0x0FFF0000 0x03ED00D1 0x0000075C 0x07AD0198
                                    0x00000E65 0x0FFF082E 0x0FFF082E 0x04A300CC 0x000009C2 0x00100C03
                                    0x00000000 0x00002710 0x00006461 0x00006461 0x00A30064 0x00A30064
                                    0x043808E8 0x0000006D 0x0000020B 0x00000020 0x00000000 0x092C030D
                                    0x0FFF0DC4 0x1E061E06 0x1E061E06 0x00000008 0x01790087 0x00120024
                                    0x016F0005 0x001C0101 0x00000007 0x00000000 0x00000000 0x00000000
                                    0x00000009 0x056D7C52 0x7FAE7D1E 0x04000079 0x021A0400 0x00007EE2
                                    0x00000000 0x00000000 0x00000000 0x00000000 0x00000000 0x00000000
                                    0x00000000 0x00000000 0x00000000 0x00000000 0x00000000 0x00000000
                                    0x00000000 0x00000000 0x00000000 0x00000000 0x00000000 0x00000000
                                    0x00000000 0x00000000 0x00000000 0x00000000 0x00000000 0x00000000
                                    0x00000000 0x00000000 0x00000000 0x00000000 0x00000000 0x00000000
                                    0x0020E04A 0x003C9FC4 0x0017AF51 0x00408040 0x00000000 0x00000000
                                    0x1C1C044E 0x00140000 0x0007FFFF 0x00140000 0x00040000 0x00000000
                                    0x00000000 0x0003FFFF 0x0003FFFF 0x00000000 0x00000000 0x07940708
                                    0x00000000 0x01400001

    // hdr: 6
    0x29 0x01 0x00 0x09 0x0006 0x5E 0x0001000C 0xF00309D0
                                    0x00003068 0x0FFF0000 0x0FFF0000 0x04E80273 0x0000075C 0x099804CB
                                    0x00000E65 0x0FFF082E 0x0FFF082E 0x099904CC 0x00000E66 0x00140A02
                                    0x00000000 0x000000C8 0x00002828 0x00002828 0x02220028 0x02220028
                                    0x043808E8 0x0000006D 0x00000100 0x00000020 0x00000000 0x092C030D
                                    0x0FFF0DC4 0x1E061E06 0x1E061E06 0x00000008 0x018C0049 0x0000001E
                                    0x01750000 0x000E0151 0x00000002 0x00000000 0x00000000 0x00000000
                                    0x00000009 0x04B27CA7 0x7F597D5A 0x040000E9 0x02640400 0x00007EA6
                                    0x00000000 0x00000000 0x00000000 0x00000000 0x00000000 0x00000000
                                    0x00000000 0x00000000 0x00000000 0x00000000 0x00000000 0x00000000
                                    0x00000000 0x00000000 0x00000000 0x00000000 0x00000000 0x00000000
                                    0x00000000 0x00000000 0x00000000 0x00000000 0x00000000 0x00000000
                                    0x00000000 0x00000000 0x00000000 0x00000000 0x00000000 0x00000000
                                    0x0020E04A 0x003C9FC4 0x0017AF51 0x00408040 0x00000000 0x00000000
                                    0x1C1C044E 0x00140000 0x0007FFFF 0x00140000 0x00040000 0x00000000
                                    0x00000000 0x0003FFFF 0x0003FFFF 0x00000000 0x00000000 0x07940708
                                    0x00000000 0x01100001

    // hdr: 9
    0x29 0x01 0x00 0x09 0x0009 0x5E 0x0001000C 0xF00309D0
                                    0x0000004D 0x0FFF0000 0x0FFF0000 0x04E80273 0x0000075C 0x099804CB
                                    0x00000E65 0x0FFF082E 0x0FFF082E 0x099904CC 0x00000E66 0x00140A02
                                    0x00000000 0x000000C8 0x00002828 0x00002828 0x02220028 0x02220028
                                    0x043808E8 0x0000006D 0x00000100 0x00000020 0x00000000 0x092C030D
                                    0x0FFF0DC4 0x1E061E06 0x1E061E06 0x00000008 0x018C0049 0x0000001E
                                    0x01750000 0x000E0151 0x00000002 0x00000000 0x00000000 0x00000000
                                    0x00000009 0x056D7C52 0x7FAE7D1E 0x04000079 0x021A0400 0x00007EE2
                                    0x00000000 0x00000000 0x00000000 0x00000004 0x08000800 0x00000800
                                    0x0F0D7EAF 0x7B6E0BCC 0x00000000 0x00000000 0x00000000 0x00000000
                                    0x00000008 0x056D7C52 0x7FAE7D1E 0x04000079 0x021A0400 0x00007EE2
                                    0x00040000 0x00000000 0x00040000 0x00000000 0x00000000 0x00000000
                                    0x00000000 0x00000000 0x00000000 0x00000000 0x00000000 0x00000000
                                    0x0015EB43 0x002FAED1 0x000FB947 0x00408040 0x00000000 0x00000003
                                    0x110A3617 0x00140000 0x0007FFFF 0x00140001 0x00040000 0x00000000
                                    0x00000000 0x00000000 0x00000000 0x00000001 0x00000001 0x07940708
                                    0x00000000 0x01100001

    // hdr: c
    0x29 0x01 0x00 0x09 0x000C 0x5E 0x0001000C 0xF00309D0
                                    0x00001028 0x0FFF0000 0x0FFF0000 0x03ED00D1 0x0000075C 0x07AD0198
                                    0x00000E65 0x0FFF082E 0x0FFF082E 0x04A300CC 0x000009C2 0x00100C03
                                    0x00000000 0x00002710 0x00006461 0x00006461 0x00A30064 0x00A30064
                                    0x043808E8 0x0000006D 0x0000020B 0x00000020 0x00000000 0x092C030D
                                    0x0FFF0DC4 0x1E061E06 0x1E061E06 0x00000008 0x01790087 0x00120024
                                    0x016F0005 0x001C0101 0x00000007 0x00000000 0x00000000 0x00000000
                                    0x00000009 0x056D7C52 0x7FAE7D1E 0x04000079 0x021A0400 0x00007EE2
                                    0x00000000 0x00000000 0x00000000 0x00000004 0x08000800 0x00000800
                                    0x0E2D7D3F 0x7A490B37 0x00000000 0x00000000 0x00000000 0x00000000
                                    0x00000008 0x04B27CA7 0x7F597D5A 0x040000E9 0x02640400 0x00007EA6
                                    0x00040000 0x00000000 0x00040000 0x00000000 0x00000000 0x00000000
                                    0x00000000 0x00000000 0x00000000 0x00000000 0x00000000 0x00000000
                                    0x0020E04A 0x003C9FC4 0x0017AF51 0x00408040 0x00000000 0x00000000
                                    0x1018044E 0x00140000 0x0007FFFF 0x00140001 0x00040000 0x00000000
                                    0x00000000 0x0003FFFF 0x0003FFFF 0x00000001 0x00000001 0x07940708
                                    0x00000000 0x01100001

    // hdr: lut
    0x29 0x01 0x00 0x09 0x00FE 0x102 0x0001000C 0xF0030B40
                                    0x00000000 0x00000000 0x00000000 0x00000000 0x00000000 0x00000000
                                    0x00000000 0x00000000 0x00000000 0x00000000 0x00000000 0x00000000
                                    0x00000000 0x00000000 0x00000000 0x00000000 0x00000000 0x00000000
                                    0x00000000 0x00000000 0x00000000 0x00000000 0x00000000 0x00000000
                                    0x00000000 0x00000000 0x00000000 0x00000000 0x00000000 0x00000000
                                    0x00000000 0x00000000 0x00000000 0x00000000 0x00000000 0x00000000
                                    0x00000000 0x00000000 0x00000000 0x00000000 0x00000000 0x00000000
                                    0x00000000 0x00000000 0x00000000 0x00000000 0x00000000 0x00000000
                                    0x00000000 0x00000000 0x00000000 0x00000000 0x00000000 0x00000000
                                    0x00000000 0x00000000 0x00000000 0x00000000 0x00000000 0x00000000
                                    0x00000000 0x00000000 0x00000000 0x00000000 0x00000000 0x00000000
                                    0x00000000 0x00000000 0x00000000 0x00000000 0x00000000 0x00000000
                                    0x00000000 0x00000000 0x00000000 0x00000000 0x00000000 0x00000000
                                    0x00000000 0x00000000 0x00000000 0x00000000 0x00000000 0x00000000
                                    0x00000000 0x00000000 0x00000000 0x00000000 0x00000000 0x00000000
                                    0x00000000 0x00000000 0x00000000 0x00000000 0x00000000 0x00000000
                                    0x00000000 0x00000000 0x00000000 0x00000000 0x00000000 0x00000000
                                    0x00000000 0x00000000 0x00000000 0x00000000 0x00000000 0x00000000
                                    0x00000000 0x00000000 0x00000000 0x00000000 0x00000000 0x00000000
                                    0x00000000 0x00000000 0x00000000 0x00000000 0x00000000 0x00000000
                                    0x00000000 0x00000000 0x00000000 0x00000000 0x00000000 0x00000000
                                    0x00000000 0x00000000 0x00000000 0x00000000 0x00000000 0x00000000
                                    0x00000000 0x00000000 0x00000000 0x00000000 0x00000000 0x00000000
                                    0x00000000 0x00000000 0x00000000 0x00000000 0x00000000 0x00000000
                                    0x00000000 0x00000000 0x00000000 0x00000000 0x00000000 0x00000000
                                    0x00000000 0x00000000 0x00000000 0x00000000 0x00000000 0x00000000
                                    0x00000000 0x00000000 0x00000000 0x00000000 0x00000000 0x00000000
                                    0x00000000 0x00000000 0x00000000 0x00000000 0x00000000 0x00000000
                                    0x00000000 0x00000000 0x00000000 0x00000000 0x00000000 0x00000000
                                    0x00000000 0x00000000 0x00000000 0x00000000 0x00000000 0x00000000
                                    0x00000000 0x00000000 0x00000000 0x00000000 0x00000000 0x00000000
                                    0x00000000 0x00000000 0x00000000 0x00000000 0x00000000 0x00000000
                                    0x00000000 0x00000000 0x00000000 0x00000000 0x00000000 0x00000000
                                    0x00000000 0x00000000 0x00000000 0x00000000 0x00000000 0x00000000
                                    0x00000000 0x00000000 0x00000000 0x00000000 0x00000000 0x00000000
                                    0x00000000 0x00000000 0x00000000 0x00000000 0x00000000 0x00000000
                                    0x00000000 0x00000000 0x00000000 0x00000000 0x00000000 0x00000000
                                    0x00000000 0x00000000 0x00000000 0x00000000 0x00000000 0x00000000
                                    0x00000000 0x00000000 0x00000000 0x00000000 0x00000000 0x00000000
                                    0x00000000 0x00000000 0x00000000 0x00000000 0x00000000 0x00000000
                                    0x00000000 0x00000000 0x00000000 0x00000000 0x00000000 0x00000000
                                    0x00000000 0x00000000 0x00000000 0x00000000 0x00000000 0x00000000
                                    0x00000000 0x00000000 0x00000000 0x00000000

    // hdr: demo-0
    0x29 0x01 0x00 0x09 0x00E0 0x03 0x0001000C 0xF0030F44
                                    0x00000000

    // hdr: demo-1
    0x29 0x01 0x00 0x09 0x00E1 0x03 0x0001000C 0xF0030F44
                                    0x00000001

    // hdr: gc
    0x29 0x01 0x00 0x09 0x00A0 0x003 0x0001000C 0xF0030F40
                                    0x00000800

    // hdr: ext_y_int
    0x29 0x01 0x00 0x09 0x0011 0x09 0xFFFFFFF4
                                    0xF05B0004 0x14F114D2 0xF05B0008 0x75F1154C 0xF05B0010 0x05220110 0xF05B0014 0xFC009B4

    // hdr: read
    0x29 0x01 0x00 0x09 0x0070 0x00C 0x0001000C 0xF0030F48
                                    0x10001000 0x10001000 0x00000000 0x03ED00D1 0x0FFF075C 0x00000000
                                    0x00000000 0x00000000 0x00000000 0x00000000

    // hdr: update
    0x29 0x01 0x00 0x09 0x0080 0x003 0x0001000C 0xF0030F70
                                    0x00000002

    // pwil: demo 0
    0x29 0x01 0x00 0x03 0x00E0 0x07 0x0001000C 0xF003114C
                                    0x00000000 0x00000000 0x00000000 0x00000000 0x00000000

    // pwil: demo 1
    0x29 0x01 0x00 0x03 0x00E1 0x07 0x0001000C 0xF003114C
                                    0x00000105 0x00010001 0x0474021C 0x08E50435 0x00001004

    // pwil: demo 2
    0x29 0x01 0x00 0x03 0x00E2 0x07 0x0001000C 0xF003114C
                                    0x0000010D 0x00010001 0x0474021C 0x08E50435 0x00001004

    // pwil: demo 3
    0x29 0x01 0x00 0x03 0x00E3 0x07 0x0001000C 0xF003114C
                                    0x00000109 0x0474021C 0x00730040 0x08E50435 0x00000000

    // pwil: ctrl-0
    0x29 0x00 0x00 0x03 0x00F0 0x00E 0x0001000C 0xF00310CC
                                    0x00A00284 0x0040003E 0x08E80438 0x021C021C 0x021C021C 0x08E80438
                                    0xE4100010 0x00000AAA 0x00000000 0x08E80438 0x08E80438 0x08E80438

    // pwil: timeout
    0x29 0x01 0x00 0x03 0x00F0 0x006 0x0001000C 0xF0031138
                                    0xFFFFFFFF 0x00000000 0x08E70000 0x04370000

    // pwil: ctrl-1
    0x29 0x01 0x00 0x03 0x00F1 0x003 0x0001000C 0xF0031148
                                    0x0040003E

    // pwil: ctrl-2
    0x29 0x01 0x00 0x03 0x00F2 0x008 0x0001000C 0xF00310FC
                                    0xE4100020 0x00000AAA 0x00000000 0x08E80438 0x08E80438 0x08E80438

    // pwil: ctrl-3: csc
    0x29 0x01 0x00 0x03 0x00F3 0x00B 0x0001000C 0xF0031114
                                    0x0000000F 0x0951094E 0x7FFE094E 0x10E47E4C 0x7BBD0E56 0x00000000
                                    0x00000000 0x00000000 0x00000000

    // pwil: csc-0 (hdr)
    0x29 0x01 0x00 0x03 0x0090 0x0B 0x0001000C 0xF0031114
                                    0x0000001D 0x09510951 0x00000951 0x11227E80 0x7ACC0D6E 0x00000000
                                    0x00000000 0x00000000 0x00000000
    // pwil: csc-1 (hdr)
    0x29 0x01 0x00 0x03 0x0091 0x0B 0x0001000C 0xF0031114
                                    0x0000001D 0x095A095A 0x0014095A 0x051F7FEC 0x7EFC0104 0x00007D12
                                    0x00000000 0x00000000 0x00000000

    // pwil: csc-2 (hdr)
    0x29 0x01 0x00 0x03 0x0092 0x0B 0x0001000C 0xF0031114
                                    0x0000001D 0x095A0000 0x00000000 0x09250000 0x00000925 0x00000000
                                    0x00002000 0x00000000 0x00002000

    // pwil: csc-2 (hdr)
    0x29 0x01 0x00 0x03 0x0093 0x0B 0x0001000C 0xF0031114
                                    0x0000000F 0x0951094E 0x7FFE094E 0x10E47E4C 0x7BBD0E56 0x00000000
                                    0x00000000 0x00000000 0x00000000

    // pwil: csc-3 (hdr)
    0x29 0x01 0x00 0x03 0x0094 0x0B 0x0001000C 0xF0031114
                                    0x00000011 0x09DC773A 0x090B04A8 0x13777E3B 0x013A090B 0x00007132
                                    0x000FFB58 0x000FFB58 0x000FFB58

    // pwil: channel-order-0
    0x29 0x01 0x00 0x03 0x0060 0x03 0x0001000C 0xF0031160
                                    0xC9110010

    // pwil: channel-order-1
    0x29 0x01 0x00 0x03 0x0061 0x03 0x0001000C 0xF0031160
                                    0xE4100010

    // pwil: channel-order-2
    0x29 0x01 0x00 0x03 0x0062 0x03 0x0001000C 0xF0031160
                                    0xE4100010

    // pwil: update
    0x29 0x01 0x00 0x03 0x0080 0x003 0x0001000C 0xF0031164
                                    0x00000001

    // pwil: force update
    0x29 0x01 0x00 0x03 0x0030 0x03 0xFFFFFFF4
                                    0xF024014C 0x00000002

    // dpp: csc-0
    0x29 0x01 0x00 0x0E 0x0040 0x0B 0x0001000C 0xF0030414
                                    0x00000011 0x08000000 0x00000000 0x08000000 0x00000800 0x00000000
                                    0x00000000 0x00000000 0x00000000

    // dpp: csc-1
    0x29 0x01 0x00 0x0E 0x0041 0x0B 0x0001000C 0xF0030414
                                    0x00000011 0x06A00000 0x00000000 0x06A00000 0x000006A0 0x00000000
                                    0x0B000B00 0x00000B00 0x00000B00

    // dpp: init
    0x29 0x01 0x00 0x0E 0x00F0 0x00C 0x0001000C 0xF0030410
                                    0x0000004A 0x0000001C 0x0951094E 0x7FFE094E 0x10E47E4C 0x7BBD0E56
                                    0x00000000 0x00000000 0x00000000 0x00000000

    // dpp: gamma
    0x29 0x01 0x00 0x0E 0x00FE 0x065 0x0001000C 0xF0030438
                                    0x00400000 0x00C00080 0x01400100 0x01C00180 0x02400200 0x02C00280
                                    0x03400300 0x03C00380 0x04400400 0x04C00480 0x05400500 0x05C00580
                                    0x06400600 0x06C00680 0x07400700 0x07C00780 0x08400800 0x08C00880
                                    0x09400900 0x09C00980 0x0A400A00 0x0AC00A80 0x0B400B00 0x0BC00B80
                                    0x0C400C00 0x0CC00C80 0x0D400D00 0x0DC00D80 0x0E400E00 0x0EC00E80
                                    0x0F400F00 0x0FC00F80 0x00000FFF 0x00400000 0x00C00080 0x01400100
                                    0x01C00180 0x02400200 0x02C00280 0x03400300 0x03C00380 0x04400400
                                    0x04C00480 0x05400500 0x05C00580 0x06400600 0x06C00680 0x07400700
                                    0x07C00780 0x08400800 0x08C00880 0x09400900 0x09C00980 0x0A400A00
                                    0x0AC00A80 0x0B400B00 0x0BC00B80 0x0C400C00 0x0CC00C80 0x0D400D00
                                    0x0DC00D80 0x0E400E00 0x0EC00E80 0x0F400F00 0x0FC00F80 0x00000FFF
                                    0x00400000 0x00C00080 0x01400100 0x01C00180 0x02400200 0x02C00280
                                    0x03400300 0x03C00380 0x04400400 0x04C00480 0x05400500 0x05C00580
                                    0x06400600 0x06C00680 0x07400700 0x07C00780 0x08400800 0x08C00880
                                    0x09400900 0x09C00980 0x0A400A00 0x0AC00A80 0x0B400B00 0x0BC00B80
                                    0x0C400C00 0x0CC00C80 0x0D400D00 0x0DC00D80 0x0E400E00 0x0EC00E80
                                    0x0F400F00 0x0FC00F80 0x00000FFF

    // dpp: gc
    0x29 0x01 0x00 0x0E 0x00A0 0x003 0x0001000C 0xF00305C4
                                    0x00000800

    // dpp: update
    0x29 0x01 0x00 0x0E 0x0080 0x003 0x0001000C 0xF00305C8
                                    0x00000001

    // peaking2d: level0
    0x29 0x01 0x00 0x0C 0x0000 0x1A 0x0001000C 0xF0030320
                                    0x00000000 0x00000000 0x00000000 0x00000000 0x00000000 0x00000000
                                    0x00000000 0x00000000 0x00000000 0x00000000 0x00000000 0x00000000
                                    0x00000000 0x00000000 0x00000000 0x00000000 0x00000000 0x00200040
                                    0x00000000 0x00000000 0x00FF00FF 0x00000000 0x00000000 0x000000E0

    // peaking2d: level1
    0x29 0x01 0x00 0x0C 0x0001 0x1A 0x0001000C 0xF0030320
                                    0x00000000 0x00000000 0x00E00040 0x00600010 0x00040004 0x00000000
                                    0x00F80010 0x00200012 0x00040004 0x00000000 0x00F80010 0x00200012
                                    0x00100010 0x00000000 0x00F80000 0x00200008 0x00200040 0x00200040
                                    0x00000000 0x00000001 0x00FF00FF 0x00FF0002 0x000003FF 0x000000E1

    // peaking2d: level2
    0x29 0x01 0x00 0x0C 0x0002 0x1A 0x0001000C 0xF0030320
                                    0x00000000 0x00000000 0x00E00040 0x00600010 0x00070007 0x00000000
                                    0x00F70010 0x00200012 0x00070007 0x00000000 0x00F70010 0x00200012
                                    0x00120012 0x00000000 0x00F80000 0x00200008 0x00200040 0x00200040
                                    0x00000000 0x00000001 0x00FF00FF 0x00FF0002 0x000003FF 0x000000E1

    // peaking2d: level3
    0x29 0x01 0x00 0x0C 0x0003 0x1A 0x0001000C 0xF0030320
                                    0x00000000 0x00000000 0x00E00040 0x00600010 0x00090009 0x00000000
                                    0x00F70010 0x00200012 0x00090009 0x00000000 0x00F70010 0x00200012
                                    0x00140014 0x00000000 0x00F40000 0x00200008 0x00200040 0x00200040
                                    0x00000000 0x00000001 0x00FF00FF 0x00FF0002 0x000003FF 0x000000E1

    // peaking2d: level4
    0x29 0x01 0x00 0x0C 0x0004 0x1A 0x0001000C 0xF0030320
                                    0x00000000 0x00000000 0x00E00040 0x00600010 0x00100010 0x00000000
                                    0x00F40010 0x00200012 0x00100010 0x00000000 0x00F40010 0x00200012
                                    0x00180018 0x00000000 0x00F00000 0x00200008 0x00200040 0x00200040
                                    0x00000000 0x00000001 0x00FF00FF 0x00FF0002 0x000003FF 0x000000E1

    // peaking2d: demo 0
    0x29 0x01 0x00 0x0C 0x00E0 0x07 0x0001000C 0xF0030380
                                    0x00000000 0x00000000 0x00000000 0x00000000 0x00000000

    // peaking2d: demo 1
    0x29 0x01 0x00 0x0C 0x00E1 0x07 0x0001000C 0xF0030380
                                    0x00000105 0x00010001 0x0474021C 0x08E50435 0x00001004

    // peaking2d: demo 2
    0x29 0x01 0x00 0x0C 0x00E2 0x07 0x0001000C 0xF0030380
                                    0x0000010D 0x00010001 0x0474021C 0x08E50435 0x00001004

    // peaking2d: demo 3
    0x29 0x01 0x00 0x0C 0x00E3 0x07 0x0001000C 0xF0030380
                                    0x00000109 0x0474021C 0x00730040 0x08E50435 0x00000000

    // peaking2d: csc 0
    0x29 0x01 0x00 0x0C 0x0010 0x04 0x0001000C 0xF0030394
                                    0x00000009 0x00000009

    // peaking2d: csc 1
    0x29 0x01 0x00 0x0C 0x0011 0x04 0x0001000C 0xF0030394
                                    0x00000009 0x00000008

    // peaking2d: init
    0x29 0x01 0x00 0x0C 0x00F0 0x021 0x0001000C 0xF0030320
                                    0x001E000A 0x0000000A 0x00E00020 0x025800A0 0x00780028 0x00000028
                                    0x00E00020 0x032000A0 0x003C003C 0x00000014 0x00800000 0x03200078
                                    0x003C003C 0x0000003C 0x00000000 0x03FC0000 0x00200040 0x00200040
                                    0x00030000 0x00000000 0x00FF00FF 0x00FF0004 0x003F03FF 0x000000F0
                                    0x00000000 0x00000000 0x00000000 0x00000000 0x00000000 0x00000008
                                    0x00000008

    // peaking2d: gc idle clk off
    0x29 0x01 0x00 0x0C 0x00A0 0x003 0x0001000C 0xF003039C
                                    0x00010800

    // peaking2d: gc idle clk on
    0x29 0x01 0x00 0x0C 0x00A1 0x03 0x0001000C 0xF003039C
                                    0x00010803

    // peaking2d: update
    0x29 0x01 0x00 0x0C 0x0080 0x003 0x0001000C 0xF00303A0
                                    0x00000001

    // lce: level 0
    0x29 0x01 0x00 0x0D 0x0000 0x10 0x0001000C 0xF003063C
                                    0x000E1096 0x0A140000 0x002FFFFF 0x0F100100 0x00001010 0x17C7D1F4
                                    0x1F44B1F4 0x00640096 0x00006464 0x0000280A 0x000FFC10 0x03E80010
                                    0x0080100A 0x000040A5

    // lce: level 1
    0x29 0x01 0x00 0x0D 0x0001 0x10 0x0001000C 0xF003063C
                                    0x000E1096 0x0A140000 0x002FFFFF 0x0F100100 0x00001010 0x17C7D1F4
                                    0x1F44B1F4 0x00640096 0x00006464 0x0000280A 0x000FFC10 0x03E80010
                                    0x0080100A 0x000040A6

    // lce: level 2
    0x29 0x01 0x00 0x0D 0x0002 0x10 0x0001000C 0xF003063C
                                    0x028E1096 0x0A140000 0x002FFFFF 0x001005DC 0x00001010 0x17C7D1F4
                                    0x1F4029F4 0x00000096 0x0000C846 0x0000280A 0x000FFC10 0x03E80010
                                    0x0080100A 0x000040A6

    // lce: level 3
    0x29 0x01 0x00 0x0D 0x0003 0x10 0x0001000C 0xF003063C
                                    0x032E1096 0x0A140000 0x002FFFFF 0x19100190 0x00001010 0x17C7D1F4
                                    0x1F4641F4 0x00960096 0x00010482 0x0000280A 0x000FFC10 0x03E80010
                                    0x0080100A 0x000040A6

    // lce: level 4
    0x29 0x01 0x00 0x0D 0x0004 0x10 0x0001000C 0xF003063C
                                    0x04BE1096 0x0A140000 0x002FFFFF 0x191001C2 0x00001010 0x17C7D1F4
                                    0x1F4709F4 0x00C80096 0x00016896 0x0000280A 0x000FFC10 0x03E80010
                                    0x0080100A 0x000040A6

    // lce: level 5
    0x29 0x01 0x00 0x0D 0x0005 0x10 0x0001000C 0xF003063C
                                    0x064E1096 0x0A140000 0x002FFFFF 0x191001F4 0x00001010 0x17C7D1F4
                                    0x1F4709F4 0x00C800C8 0x0001CCAF 0x0000280A 0x000FFC10 0x03E80010
                                    0x0080100A 0x000040A6

    // lce: level 6
    0x29 0x01 0x00 0x0D 0x0006 0x10 0x0001000C 0xF003063C
                                    0x014E1096 0x0A140000 0x002FFFFF 0x0F100168 0x00001010 0x17C7D1F4
                                    0x1F4029F4 0x000000AF 0x0000A078 0x0000280A 0x000FFC10 0x03E80010
                                    0x0080100A 0x000040A5

    // lce: level 7
    0x29 0x01 0x00 0x0D 0x0007 0x10 0x0001000C 0xF003063C
                                    0x014E1096 0x0A140000 0x002FFFFF 0x0F100168 0x00001010 0x17C7D1F4
                                    0x1F4029F4 0x000000AF 0x0000A078 0x0000280A 0x000FFC10 0x03E80010
                                    0x0080100A 0x000040A6

    // lce: level 8
    0x29 0x01 0x00 0x0D 0x0008 0x10 0x0001000C 0xF003063C
                                    0x032E1096 0x0A140000 0x002FFFFF 0x1E10017C 0x00001010 0x17C7D1F4
                                    0x1F4029F4 0x000000C8 0x0000F096 0x0000280A 0x000FFC10 0x03E80010
                                    0x0080100A 0x000040A6

    // lce: level 9
    0x29 0x01 0x00 0x0D 0x0009 0x10 0x0001000C 0xF003063C
                                    0x05AE1096 0x0A140000 0x002FFFFF 0x1E1001D6 0x00001010 0x17C7D1F4
                                    0x1F4029F4 0x000000C8 0x000154A5 0x0000280A 0x000FFC10 0x03E80010
                                    0x0080100A 0x000040A6

    // lce: level 10
    0x29 0x01 0x00 0x0D 0x000A 0x10 0x0001000C 0xF003063C
                                    0x082E1096 0x0A140000 0x002FFFFF 0x1E100230 0x00001010 0x17C7D1F4
                                    0x1F4029F4 0x000000C8 0x0001B8B4 0x0000280A 0x000FFC10 0x03E80010
                                    0x0080100A 0x000040A6

    // lce: level 11
    0x29 0x01 0x00 0x0D 0x000B 0x10 0x0001000C 0xF003063C
                                    0x0AAE1096 0x0A140000 0x002FFFFF 0x1E10028A 0x00001010 0x17C7D1F4
                                    0x1F4029F4 0x000000FA 0x000244C8 0x0000280A 0x000FFC10 0x03E80010
                                    0x0080100A 0x000040A6

    // lce: gra_det 0
    0x29 0x01 0x00 0x0D 0x0010 0x03 0x0001000C 0xF0030674
                                    0x2804003C

    // lce: gra_det 1
    0x29 0x01 0x00 0x0D 0x0011 0x03 0x0001000C 0xF0030674
                                    0x2804083C

    // lce: demo 0
    0x29 0x01 0x00 0x0D 0x00E0 0x03 0x0001000C 0xF0030678
                                    0x00000000

    // lce: demo 1
    0x29 0x01 0x00 0x0D 0x00E1 0x03 0x0001000C 0xF0030678
                                    0x00000001

    // lce: init
    0x29 0x01 0x00 0x0D 0x00F0 0x02E 0x0001000C 0xF00305CC
                                    0x04370000 0x08E70000 0x000180C0 0x000180C0 0x000180C0 0x000180C0
                                    0x00017C5A 0x00017FE8 0x00017C5A 0x00017D30 0x00017D30 0x001C80D8
                                    0x00000100 0x001B00D8 0x00360288 0x003901C8 0x00720558 0x00066667
                                    0x00066667 0x00000412 0x00010453 0x00000419 0x00010625 0x00040000
                                    0x00000000 0x00000F30 0x00000731 0x000001B5 0x000E1096 0x0A140000
                                    0x002FFFFF 0x0F100100 0x00001010 0x17C7D1F4 0x1F4029F4 0x00000096
                                    0x00006464 0x0000280A 0x000FFC10 0x03E80010 0x0081100A 0x000040A5
                                    0x2804003C 0x00000000

    // lce: gc
    0x29 0x01 0x00 0x0D 0x00A0 0x003 0x0001000C 0xF003067C
                                    0x00000000

    // lce: read 0
    0x29 0x01 0x00 0x0D 0x0070 0x0D4 0x0001000C 0xF0030680
                                    0x40000000 0x00000043 0x06010020 0x0C028080 0x120400E0 0x18058140
                                    0x1E0701A0 0x24088200 0x2A0A0260 0x300B82C0 0x360D0320 0x3C0E8380
                                    0x00000000 0x00000000 0x00000000 0x00000000 0x00000000 0x00000000
                                    0x00000000 0x00000000 0x00000000 0x00000000 0x00000000 0x00000000
                                    0x00000000 0x00000000 0x00000000 0x00000000 0x00000000 0x00000000
                                    0x00000000 0x00000000 0x00000000 0x00000000 0x00000000 0x00000000
                                    0x00000000 0x00000000 0x00000000 0x00000000 0x00000000 0x00000000
                                    0x00000000 0x00000000 0x00000000 0x00000000 0x000003E0 0x01002000
                                    0x00000000 0x00000000 0x00000000 0x00000000 0x00000000 0x00000000
                                    0x00000000 0x00000000 0x00000000 0x00000000 0x00000000 0x00000000
                                    0x00000000 0x00000000 0x00000000 0x00000000 0x00000000 0x00000000
                                    0x00000000 0x00000000 0x00000000 0x00000000 0x00000000 0x00000000
                                    0x00000000 0x00000000 0x00000000 0x00000000 0x00000000 0x00000000
                                    0x00000000 0x00000000 0x00000000 0x00000000 0x00000000 0x00000000
                                    0x00000000 0x00000000 0x00000000 0x00000000 0x00000000 0x00000000
                                    0x00000000 0x00000000 0x00000000 0x00000000 0x00000000 0x00000000
                                    0x00000000 0x00000000 0x00000000 0x00000000 0x00000000 0x00000000
                                    0x00000000 0x00000000 0x00000000 0x00000000 0x00000000 0x00000000
                                    0x00000000 0x00000000 0x00000000 0x00000000 0x00000000 0x00000000
                                    0x00000000 0x00000000 0x00000000 0x00000000 0x00000000 0x00000000
                                    0x00000000 0x00000000 0x00000000 0x00000000 0x00000000 0x00000000
                                    0x00000000 0x00000000 0x00000000 0x00000000 0x00000000 0x00000000
                                    0x00000000 0x00000000 0x00000000 0x00000000 0x00000000 0x00000000
                                    0x00000000 0x00000000 0x00000000 0x00000000 0x00000000 0x00000000
                                    0x00000000 0x00000000 0x00000000 0x00000000 0x00000000 0x00000000
                                    0x00000000 0x00000000 0x00000000 0x00000000 0x00000000 0x00000000
                                    0x00000000 0x00000000 0x00000000 0x00000000 0x00000000 0x00000000
                                    0x00000000 0x00000000 0x00000000 0x00000000 0x00000000 0x00000000
                                    0x00000000 0x00000000 0x00000000 0x00000000 0x00000000 0x00000000
                                    0x00000000 0x00000000 0x00000000 0x00000000 0x00000000 0x00000000
                                    0x00000000 0x00000000 0x00000000 0x00000000 0x00000000 0x00000000
                                    0x00000000 0x00000000 0x00000000 0x00000000 0x00000000 0x00000000
                                    0x00000000 0x00000000 0x00000000 0x00000000 0x00000000 0x00000000
                                    0x00000000 0x00000000 0x00000000 0x00000000 0x00000000 0x00000000
                                    0x00000000 0x00000000 0x00000000 0x00000000 0x00000000 0x00000000

    // lce: read 4
    0x29 0x01 0x00 0x0D 0x0071 0x003 0x0001000C 0xF00309CC
                                    0x80000001

    // lce: update
    0x29 0x01 0x00 0x0D 0x0080 0x003 0x0001000C 0xF00309C8
                                    0x00000004

    // cm: 6axis 0
    0x29 0x01 0x00 0x0A 0x0000 0x04 0x0001000C 0xF00303A4
                                    0x0820E000 0x0B440C10

    // cm: 6axis 1
    0x29 0x01 0x00 0x0A 0x0001 0x04 0x0001000C 0xF00303A4
                                    0x0820E800 0x0B040C00

    // cm: 6axis 2
    0x29 0x01 0x00 0x0A 0x0002 0x04 0x0001000C 0xF00303A4
                                    0x0820EC00 0x0B040C00

    // cm: 6axis 3
    0x29 0x01 0x00 0x0A 0x0003 0x04 0x0001000C 0xF00303A4
                                    0x0820EFC0 0x0B040C00

    // cm: ftc 0
    0x29 0x01 0x00 0x0A 0x0010 0x03 0x0001000C 0xF00303C0
                                    0x00002215

    // cm: ftc 1
    0x29 0x01 0x00 0x0A 0x0011 0x03 0x0001000C 0xF00303C0
                                    0x002C2215

    // cm: csc 0
    0x29 0x01 0x00 0x0A 0x0040 0x07 0x0001000C 0xF00303DC
                                    0x00000019 0x08000800 0x00000800 0x0E307D40 0x7A480B38

    // cm: csc 1
    0x29 0x01 0x00 0x0A 0x0041 0x07 0x0001000C 0xF00303DC
                                    0x00000019 0x08000800 0x00000800 0x07177EA0 0x7D25059C

    // cm: csc 2
    0x29 0x01 0x00 0x0A 0x0045 0x07 0x0001000C 0xF00303DC
                                    0x00000019 0x08000800 0x00000800 0x0F0D7EAF 0x7B6E0BCC

    // cm: csc 3
    0x29 0x01 0x00 0x0A 0x0046 0x07 0x0001000C 0xF00303DC
                                    0x00000019 0x08000800 0x00000800 0x0F0D7EAF 0x7B6E0BCC

    // cm: demo 0
    0x29 0x01 0x00 0x0A 0x00E0 0x04 0x0001000C 0xF0030400
                                    0x00000000 0x00000000

    // cm: demo 1
    0x29 0x01 0x00 0x0A 0x00E1 0x04 0x0001000C 0xF0030400
                                    0x00000007 0x3FF00000

    // cm: demo 2
    0x29 0x01 0x00 0x0A 0x00E2 0x04 0x0001000C 0xF0030400
                                    0x00000017 0x3FF00000

    // cm: init
    0x29 0x00 0x00 0x0A 0x00F0 0x00A 0x0001000C 0xF00303A4
                                    0x0820EFC0 0x03040C10 0x00000000 0x00000160 0x7A067844 0x1C43FF10
                                    0x15440018 0x002C2215

    // cm: init csc
    0x29 0x00 0x00 0x0A 0x00F0 0x00B 0x0001000C 0xF00303DC
                                    0x0000001D 0x0951094E 0x7FFE094E 0x10E47E4C 0x7BBD0E56 0x00000000
                                    0x00000000 0x00000000 0x00000000

    // cm: init demo
    0x29 0x01 0x00 0x0A 0x00F0 0x004 0x0001000C 0xF0030400
                                    0x00000000 0x00000000

    // cm: gc
    0x29 0x01 0x00 0x0A 0x00A0 0x003 0x0001000C 0xF0030408
                                    0x00000800

    // cm: update
    0x29 0x01 0x00 0x0A 0x0080 0x003 0x0001000C 0xF003040C
                                    0x00000100

    // scaler1d
    0x29 0x01 0x00 0x0B 0x00F0 0x013 0x0001000C 0xF0030F94
                                    0x00006620 0x00000441 0x00080000 0x00080000 0x00006400 0x08E808E8
                                    0x00020003 0x00020003 0x00000000 0x00000016 0x04380438 0x00080000
                                    0x00080000 0x00020003 0x00020003 0x0000640A 0x00000000
    // scaler1d: gc
    0x29 0x01 0x00 0x0B 0x00A0 0x003 0x0001000C 0xF0030FD8
                                    0x00000800

    // dbc: gc
    0x29 0x01 0x00 0x0F 0x00A0 0x003 0x0001000C 0xF0031168
                                    0x00000800

    // dbc: init
    0x29 0x00 0x00 0x0F 0x00F0 0x037 0x0001000C 0xF00312F0
                                    0x50850421 0x00000000 0x00000000 0x0000003F 0x00000000 0x00000080
                                    0x0000012C 0x00000400 0x00000600 0x00000E00 0x000002EC 0x00000400
                                    0x00000448 0x00000197 0x000002C5 0x00000300 0x000000D6 0x00000067
                                    0x00000009 0x00000043 0x00000026 0x00000004 0x00000140 0x000003CB
                                    0x000001CC 0x0000003F 0x00000002 0x00000FFF 0x000003CB 0x000001CC
                                    0x00000000 0x0000000E 0x00000800 0x00000000 0x00000B38 0x00000800
                                    0x00007D3E 0x00007A4A 0x00000800 0x00000E2C 0x00007FFE 0x00000800
                                    0x00000000 0x00000B38 0x00000800 0x00007D3E 0x00007A4A 0x00000800
                                    0x00000E2C 0x00007FFE 0x00000000 0x000003FF 0x00000FFF

    // dbc: init plcdcompw
    0x29 0x01 0x00 0x0F 0x00F0 0x023 0x0001000C 0xF003116C
                                    0x000003FF 0x000003E0 0x000003C0 0x000003A0 0x00000380 0x00000360
                                    0x00000340 0x00000320 0x00000300 0x000002E6 0x000002CD 0x000002B3
                                    0x0000029A 0x00000280 0x00000266 0x0000024D 0x00000233 0x0000021A
                                    0x00000200 0x000001E6 0x000001CD 0x000001B3 0x0000019A 0x00000180
                                    0x00000166 0x0000013A 0x0000010D 0x000000E0 0x000000B3 0x00000087
                                    0x0000005A 0x0000002D 0x00000000

    // dbc: COREX0K0
    0x29 0x01 0x00 0x0F 0x00FE 0x042 0x0001000C 0xF00311F0
                                    0x00000000 0x00000000 0x00017029 0x0001F028 0x00026029 0x0002C02B
                                    0x0003302C 0x0003902D 0x0003F02E 0x0004502F 0x0004B030 0x00050031
                                    0x00055032 0x0005A033 0x0005E035 0x00062036 0x00066038 0x0006A039
                                    0x0006D03B 0x0007103C 0x0007403E 0x00076040 0x00079041 0x0007B043
                                    0x0007D045 0x0007E048 0x0008004A 0x0008104C 0x0008204F 0x00083051
                                    0x00083054 0x00083058 0x0003F000 0x0003F000 0x03A7F17F 0x04E7F1FF
                                    0x0627F27F 0x076FF2FF 0x08B7F37F 0x09FFF3FF 0x0B4FF47F 0x0C9FF4FF
                                    0x0DF7F57F 0x0F4FF5FF 0x10A7F67F 0x1207F6FF 0x1367F77F 0x14CFF7FF
                                    0x1637F87F 0x179FF8FF 0x190FF97F 0x1A7FF9FF 0x1BF7FA7F 0x1D6FFAFF
                                    0x1EE7FB7F 0x2067FBFF 0x21E7FC7F 0x236FFCFF 0x24F7FD7F 0x267FFDFF
                                    0x280FFE7F 0x299FFEFF 0x2B37FF7F 0x2CCFFFFF

    // dbc: read
    0x29 0x01 0x00 0x0F 0x0070 0x01A 0x0001000C 0xF00313C4
                                    0x00000000 0x00000000 0x00000000 0x00000000 0x00000FFF 0x00000FFF
                                    0x00001000 0x00000000 0x00000000 0x00000000 0x00000000 0x00000000
                                    0x000003FF 0x00000000 0x00000000 0x00000000 0x00000000 0x00000000
                                    0x00000000 0x00000000 0x00000000 0x00000063 0x00000000 0x00000FFF

    // dbc: off
    0x29 0x01 0x00 0x0F 0x0000 0x03 0x0001000C 0xF00312F0
                                    0x40850423

    // dbc: on
    0x29 0x01 0x00 0x0F 0x0001 0x03 0x0001000C 0xF00312F0
                                    0x40840423

    // dbc: level 0
    0x29 0x01 0x00 0x0F 0x0010 0x04 0x0001000C 0xF0031354
                                    0x00000000 0x00000000

    // dbc: level 1
    0x29 0x01 0x00 0x0F 0x0011 0x04 0x0001000C 0xF0031354
                                    0x00000027 0x00000002

    // dbc: level 2
    0x29 0x01 0x00 0x0F 0x0012 0x04 0x0001000C 0xF0031354
                                    0x00000022 0x00000002

    // dbc: level 3
    0x29 0x01 0x00 0x0F 0x0013 0x04 0x0001000C 0xF0031354
                                    0x0000001B 0x00000002

    // dbc: compenk table 0
    0x29 0x01 0x00 0x0F 0x0020 0x03 0x0001000C 0xF00312F4
                                    0x00000000

    // dbc: compenk table 1
    0x29 0x01 0x00 0x0F 0x0021 0x03 0x0001000C 0xF00312F4
                                    0x00000001

    // dbc: income table 0
    0x29 0x01 0x00 0x0F 0x0030 0x03 0x0001000C 0xF00312F8
                                    0x00000000

    // dbc: income table 1
    0x29 0x01 0x00 0x0F 0x0031 0x03 0x0001000C 0xF00312F8
                                    0x00000001

    // dbc: RGB in
    0x29 0x01 0x00 0x0F 0x0040 0x03 0x0001000C 0xF003136C
                                    0x00000006

    // dbc: YUV in
    0x29 0x01 0x00 0x0F 0x0041 0x03 0x0001000C 0xF003136C
                                    0x00000007

    // dsc_dec: init
    0x29 0x01 0x00 0x07 0x00F0 0x01A 0x0001000C 0xF0030FDC
                                    0x00000000 0x00000000 0x00000000 0x00000000 0x00000000 0x00000000
                                    0x00000000 0x00000000 0x00000000 0x00000000 0x00000000 0x00000000
                                    0x00000000 0x00000000 0x00000000 0x00000000 0x00000000 0x00000000
                                    0x00000000 0x00000000 0x00000000 0x00000000 0x00000000 0x00000000

    // dsc-dec: gc
    0x29 0x01 0x00 0x07 0x00A0 0x003 0x0001000C 0xF003103C
                                    0x00000800

    // dsc-dec: update
    0x29 0x01 0x00 0x07 0x0080 0x003 0x0001000C 0xF0031040
                                    0x00000001

    // dsc_enc: init
    0x29 0x01 0x00 0x08 0x00F0 0x022 0x0001000C 0xF0031044
                                    0x00000003 0x00000002 0x00000000 0x00000000 0x00000000 0x00000000
                                    0x00000000 0x00000000 0x00000000 0x00000000 0x00000000 0x00000000
                                    0x00000000 0x00000000 0x00000000 0x00000000 0x00000000 0x00000000
                                    0x00000000 0x00000000 0x00000000 0x00000000 0x00000000 0x00000000
                                    0x00000000 0x00000000 0x00000000 0x00000000 0x00000000 0x00000000
                                    0x00000000 0x00000000

    // dsc_enc: gc
    0x29 0x01 0x00 0x08 0x00A0 0x003 0x0001000C 0xF00310C4
                                    0x00000000

    // dsc-enc: update
    0x29 0x01 0x00 0x08 0x0080 0x003 0x0001000C 0xF00310C8
                                    0x00000004

    // dma: init
    0x29 0x01 0x00 0x11 0x00F0 0xA6 0x0001000C 0xF0030000
                                    0x80180320 0xF0A00000 0x80050380 0xF0A00074 0x80020394 0xF0A0006C
                                    0x8001039C 0xF0A00060 0x800103A0 0xF0A00090 0x800803A4 0xF0560000
                                    0x800103C4 0xF0560038 0x800103C8 0xF0560054 0x800103CC 0xF0560070
                                    0x800103D0 0xF056008C 0x800103D4 0xF05600A8 0x800103D8 0xF05600C4
                                    0x800903DC 0xF056010C 0x80020400 0xF0560104 0x80010408 0xF05600F8
                                    0x8001040C 0xF0560140 0x80010410 0xF0580000 0x80090414 0xF0580014
                                    0x80320438 0xF0580040 0x80310500 0xF0580108 0x800105C4 0xF058000C
                                    0x800105C8 0xF05801D0 0x840205CC 0xF0520064 0x840F05D4 0xF0520094
                                    0x840B0610 0xF05200F8 0x840E063C 0xF0520000 0x84010674 0xF0520054
                                    0x84010678 0xF052006C 0x8401067C 0xF0520058 0xC4400680 0xF0531008
                                    0xC4400780 0xF0531108 0xC4400880 0xF0531208 0xC4120980 0xF0531308
                                    0x840109C8 0xF0531000 0xC40109CC 0xF0531004 0x802D09D0 0xF05A0000
                                    0x802F0A84 0xF05A00B4 0x80400B40 0xF05A1400 0x80400C40 0xF05A1500
                                    0x80400D40 0xF05A1600 0x80400E40 0xF05A1700 0x80010F40 0xF05AFF08
                                    0x80010F44 0xF05A0170 0xC00A0F48 0xF05B0004 0x80010F70 0xF05B0000
                                    0x80060F74 0xF0220000 0x80010F8C 0xF0220028 0x80010F90 0xF0220064
                                    0x80110F94 0xF0A20000 0x80010FD8 0xF0A20044 0x0C020FDC 0xF0680000
                                    0x0C160FE4 0xF068000C 0x0C01103C 0xF0680008 0x0C011040 0xF069FF00
                                    0x08021044 0xF0600000 0x0816104C 0xF0600064 0x080810A4 0xF0600008
                                    0x080110C4 0xF0600054 0x080110C8 0xF0600114 0x800C10CC 0xF0240000
                                    0x000610FC 0xF0240030 0x80091114 0xF024004C 0x80011138 0xF0240084
                                    0x8003113C 0xF0240140 0x80011148 0xF0240004 0x8005114C 0xF024010C
                                    0x80011160 0xF0240018 0x80011164 0xF024014C 0x84011168 0xF0540404
                                    0x8421116C 0xF0540178 0x844011F0 0xF0540304 0x840512F0 0xF0540000
                                    0x84121304 0xF0540014 0x8402134C 0xF0540080 0x84021354 0xF05400C8
                                    0x8401135C 0xF05400DC 0x84021360 0xF0540100 0x84011368 0xF054015C
                                    0x8413136C 0xF054040C 0x840313B8 0xF0540458 0xC41813C4 0xF0558000
                                    0x80011424 0xF0240000

    // dma: init no read
    0x29 0x01 0x00 0x11 0x00F1 0xA6 0x0001000C 0xF0030000
                                    0x80180320 0xF0A00000 0x80050380 0xF0A00074 0x80020394 0xF0A0006C
                                    0x8001039C 0xF0A00060 0x800103A0 0xF0A00090 0x800803A4 0xF0560000
                                    0x800103C4 0xF0560038 0x800103C8 0xF0560054 0x800103CC 0xF0560070
                                    0x800103D0 0xF056008C 0x800103D4 0xF05600A8 0x800103D8 0xF05600C4
                                    0x800903DC 0xF056010C 0x80020400 0xF0560104 0x80010408 0xF05600F8
                                    0x8001040C 0xF0560140 0x80010410 0xF0580000 0x80090414 0xF0580014
                                    0x80320438 0xF0580040 0x80310500 0xF0580108 0x800105C4 0xF058000C
                                    0x800105C8 0xF05801D0 0x840205CC 0xF0520064 0x840F05D4 0xF0520094
                                    0x840B0610 0xF05200F8 0x840E063C 0xF0520000 0x84010674 0xF0520054
                                    0x84010678 0xF052006C 0x8401067C 0xF0520058 0x44400680 0xF0531008
                                    0x44400780 0xF0531108 0x44400880 0xF0531208 0x44120980 0xF0531308
                                    0x840109C8 0xF0531000 0x440109CC 0xF0531004 0x802D09D0 0xF05A0000
                                    0x802F0A84 0xF05A00B4 0x80400B40 0xF05A1400 0x80400C40 0xF05A1500
                                    0x80400D40 0xF05A1600 0x80400E40 0xF05A1700 0x80010F40 0xF05AFF08
                                    0x80010F44 0xF05A0170 0x400A0F48 0xF05B0004 0x80010F70 0xF05B0000
                                    0x80060F74 0xF0220000 0x80010F8C 0xF0220028 0x80010F90 0xF0220064
                                    0x80110F94 0xF0A20000 0x80010FD8 0xF0A20044 0x0C020FDC 0xF0680000
                                    0x0C160FE4 0xF068000C 0x0C01103C 0xF0680008 0x0C011040 0xF069FF00
                                    0x08021044 0xF0600000 0x0816104C 0xF0600064 0x080810A4 0xF0600008
                                    0x080110C4 0xF0600054 0x080110C8 0xF0600114 0x800C10CC 0xF0240000
                                    0x000610FC 0xF0240030 0x80091114 0xF024004C 0x80011138 0xF0240084
                                    0x8003113C 0xF0240140 0x80011148 0xF0240004 0x8005114C 0xF024010C
                                    0x80011160 0xF0240018 0x80011164 0xF024014C 0x84011168 0xF0540404
                                    0x8421116C 0xF0540178 0x844011F0 0xF0540304 0x840512F0 0xF0540000
                                    0x84121304 0xF0540014 0x8402134C 0xF0540080 0x84021354 0xF05400C8
                                    0x8401135C 0xF05400DC 0x84021360 0xF0540100 0x84011368 0xF054015C
                                    0x8413136C 0xF054040C 0x840313B8 0xF0540458 0x441813C4 0xF0558000
                                    0x80011424 0xF0240000

    // dma: init ctrl
    0x29 0x01 0x00 0x11 0x00E1 0x09 0xFFFFFFF4
                                    0xF0020000 0x00000001 0xF0020004 0x00000000 0xF0020008 0x00520000
                                    0xF0020004 0x00000003

    // dma: write core
    0x29 0x01 0x00 0x11 0x00E2 0x05 0xFFFFFFF4
                                    0xF0020004 0x00000000 0xF0020004 0x00000001

    // dma: write lce
    0x29 0x01 0x00 0x11 0x00E3 0x05 0xFFFFFFF4
                                    0xF0020004 0x00000000 0xF0020004 0x00000002

    // dma: read core lce
    0x29 0x01 0x00 0x11 0x00E4 0x05 0xFFFFFFF4
                                    0xF0020004 0x00000000 0xF0020004 0x00030000

    // dma: write all
    0x29 0x01 0x00 0x11 0x00E5 0x05 0xFFFFFFF4
                                    0xF0020004 0x00000000 0xF0020004 0x00000001

    // blc_pwm: init
    0x29 0x01 0x00 0x06 0x00F0 0x03 0xFFFFFFF4
                                    0xF00C0014 0x0001100A

    // blc_pwm: disable
    0x29 0x01 0x00 0x06 0x0000 0x03 0xFFFFFFF4
                                    0xF00C0000 0x00000081

    // blc_pwm: enable
    0x29 0x01 0x00 0x06 0x0001 0x03 0xFFFFFFF4
                                    0xF00C0000 0x00000084

    // bitmask pwil data path 1
    0x29 0x01 0x00 0x03 0x00FD 0x03 0x0001000C 0xF0031148
                                    0x0040003E

    // bitmask pwil capen 0
    0x29 0x01 0x00 0x03 0x0050 0x03 0xFFFFFFF4
                                    0xF0240000 0x00A00280

    // bitmask pwil capen 1
    0x29 0x01 0x00 0x03 0x0051 0x03 0x0001000C 0xF0031424
                                    0x00A00284

    // bitmask pwil capen 0 (dma)
    0x29 0x01 0x00 0x03 0x0052 0x03 0x0001000C 0xF0031424
                                    0x00A00280

    // bitmask cm cntl 1
    0x29 0x01 0x00 0x0A 0x00FB 0x03 0x0001000C 0xF00303A4
                                    0x0820E000

    // bitmask cm cntl2 1
    0x29 0x01 0x00 0x0A 0x00FC 0x03 0x0001000C 0xF00303B0
                                    0x00000060

    // bitmask cm cntl3 1
    0x29 0x01 0x00 0x0A 0x00FD 0x03 0x0001000C 0xF00303AC
                                    0x00000000

    // bitmask cm magenta 6
    0x29 0x01 0x00 0x0A 0x00B0 0x03 0x0001000C 0xF00303C4
                                    0x00A1B818

    // bitmask cm red 6
    0x29 0x01 0x00 0x0A 0x00B1 0x03 0x0001000C 0xF00303C8
                                    0x00A1B816

    // bitmask cm yellow 6
    0x29 0x01 0x00 0x0A 0x00B2 0x03 0x0001000C 0xF00303CC
                                    0x00A1B812

    // bitmask cm green 6
    0x29 0x01 0x00 0x0A 0x00B3 0x03 0x0001000C 0xF00303D0
                                    0x00A1B81D

    // bitmask cm blue 6
    0x29 0x01 0x00 0x0A 0x00B4 0x03 0x0001000C 0xF00303D4
                                    0x00A1B812

    // bitmask cm cyan 6
    0x29 0x01 0x00 0x0A 0x00B5 0x03 0x0001000C 0xF00303D8
                                    0x00A1B823

    // bitmask lce ahe_ctrl3 1
    0x29 0x01 0x00 0x0D 0x00FD 0x03 0x0001000C 0xF0030648
                                    0x0F100100

    // bitmask sys dynamic on
    0x29 0x01 0x00 0x00 0x00F0 0x03 0xFFFFFFF4
                                    0xF0000028 0x00000009

    // bitmask sys dynamic off
    0x29 0x01 0x00 0x00 0x00F1 0x03 0xFFFFFFF4
                                    0xF0000028 0x00000008

    // bitmask sys pmu_ctrl3
    0x29 0x01 0x00 0x00 0x00FC 0x03 0xFFFFFFF4
                                    0xF0000044 0x00000007

    // bitmask blc_pwm  PWM_GEN_FREQ_SET
    0x29 0x01 0x00 0x06 0x00FD 0x03 0xFFFFFFF4
                                    0xF00C0010 0x00000001

    // bitmask dbc bl_user
    0x29 0x01 0x00 0x0F 0x00FD 0x03 0x0001000C 0xF003135C
                                    0x00000FFF

    // bitmask dbc led0d_gain
    0x29 0x01 0x00 0x0F 0x00FC 0x03 0x0001000C 0xF0031354
                                    0x00000000

    // lk: dport: init
    0x29 0x00 0x00 0x04 0x00FA 0x0D 0xFFFFFFF4
                                    0xF0220000 0xE0004E07 0xF0220004 0x21000803 0xF0220008 0x48E80438
                                    0xF022000C 0x06000800 0xF0220010 0x06081802 0xF0220014 0x00040100

    // lk: dport: init
    0x29 0x01 0x00 0x04 0x00FA 0x03 0xFFFFFFF4
                                    0xF0220028 0x00000000

    // lk: dport: update
    0x29 0x01 0x00 0x04 0x008A 0x03 0xFFFFFFF4
                                    0xF0220064 0x00000001

    // lk: pwil: ctrl
    0x29 0x00 0x00 0x03 0x00FA 0x19 0xFFFFFFF4
                                    0xF0240000 0x00A00284 0xF0240004 0x0040003E 0xF0240008 0x08E80438
                                    0xF024000C 0x021C021C 0xF0240010 0x021C021C 0xF0240014 0x08E80438
                                    0xF0240018 0xE4100010 0xF024001C 0x00000AAA 0xF0240020 0x00000000
                                    0xF0240024 0x08E80438 0xF0240028 0x08E80438 0xF024002C 0x08E80438

    // lk: pwil: timeout
    0x29 0x00 0x00 0x03 0x00FA 0x03 0xFFFFFFF4
                                    0xF0240084 0xFFFFFFFF

    // lk: pwil: ctrl
    0x29 0x01 0x00 0x03 0x00FA 0x07 0xFFFFFFF4
                                    0xF0240140 0x00000000 0xF0240144 0x08E70000 0xF0240148 0x04370000

    // lk: pwil: update
    0x29 0x01 0x00 0x03 0x008A 0x03 0xFFFFFFF4
                                    0xF024014C 0x00000001

    // lk: dsc_dec: init
    0x29 0x00 0x00 0x07 0x00FA 0x05 0xFFFFFFF4
                                    0xF0680000 0x00000000 0xF0680004 0x00000000

    // lk: dsc_dec: init pps
    0x29 0x01 0x00 0x07 0x00FA 0x2D 0xFFFFFFF4
                                    0xF068000C 0x00000000 0xF0680010 0x00000000 0xF0680014 0x00000000
                                    0xF0680018 0x00000000 0xF068001C 0x00000000 0xF0680020 0x00000000
                                    0xF0680024 0x00000000 0xF0680028 0x00000000 0xF068002C 0x00000000
                                    0xF0680030 0x00000000 0xF0680034 0x00000000 0xF0680038 0x00000000
                                    0xF068003C 0x00000000 0xF0680040 0x00000000 0xF0680044 0x00000000
                                    0xF0680048 0x00000000 0xF068004C 0x00000000 0xF0680050 0x00000000
                                    0xF0680054 0x00000000 0xF0680058 0x00000000 0xF068005C 0x00000000
                                    0xF0680060 0x00000000

    // lk: dsc_dec: update
    0x29 0x01 0x00 0x07 0x008A 0x03 0xFFFFFFF4
                                    0xF069FF00 0x00000001

    // lk: dsc_enc: init
    0x29 0x00 0x00 0x08 0x00FA 0x05 0xFFFFFFF4
                                    0xF0600000 0x00000003 0xF0600004 0x00000002

    // lk: dsc_enc: init pps
    0x29 0x00 0x00 0x08 0x00FA 0x2D 0xFFFFFFF4
                                    0xF0600064 0x00000000 0xF0600068 0x00000000 0xF060006C 0x00000000
                                    0xF0600070 0x00000000 0xF0600074 0x00000000 0xF0600078 0x00000000
                                    0xF060007C 0x00000000 0xF0600080 0x00000000 0xF0600084 0x00000000
                                    0xF0600088 0x00000000 0xF060008C 0x00000000 0xF0600090 0x00000000
                                    0xF0600094 0x00000000 0xF0600098 0x00000000 0xF060009C 0x00000000
                                    0xF06000A0 0x00000000 0xF06000A4 0x00000000 0xF06000A8 0x00000000
                                    0xF06000AC 0x00000000 0xF06000B0 0x00000000 0xF06000B4 0x00000000
                                    0xF06000B8 0x00000000

    // lk: dsc_enc: init
    0x29 0x01 0x00 0x08 0x00FA 0x11 0xFFFFFFF4
                                    0xF0600008 0x00000000 0xF060000C 0x00000000 0xF0600010 0x00000000
                                    0xF0600014 0x00000000 0xF0600018 0x00000000 0xF060001C 0x00000000
                                    0xF0600020 0x00000000 0xF0600024 0x00000000

    // lk: dsc_enc: update
    0x29 0x01 0x00 0x08 0x008A 0x03 0xFFFFFFF4
                                    0xF0600114 0x00000004

    // lk: dpp: disable
    0x29 0x01 0x00 0x0E 0x00FA 0x05 0xFFFFFFF4
                                    0xF0580014 0x0000001C 0xF05801D0 0x00000002

    // lk: peaking
    0x29 0x01 0x00 0x0C 0x00FA 0x07 0xFFFFFFF4
                                    0xF0A0005C 0x000000F0 0xF0A00070 0x00000008 0xF0A00090 0x00000001

    // lk: cm
    0x29 0x01 0x00 0x0A 0x00FA 0x05 0xFFFFFFF4
                                    0xF05600F8 0xFFFFFFFF 0xF0560140 0x00000001

    // lk: scaler: init
    0x29 0x01 0x00 0x0B 0x00FA 0x23 0xFFFFFFF4
                                    0xF0A20000 0x00006620 0xF0A20004 0x00000441 0xF0A20008 0x00080000
                                    0xF0A2000C 0x00080000 0xF0A20010 0x00006400 0xF0A20014 0x08E808E8
                                    0xF0A20018 0x00020003 0xF0A2001C 0x00020003 0xF0A20020 0x00000000
                                    0xF0A20024 0x00000016 0xF0A20028 0x04380438 0xF0A2002C 0x00080000
                                    0xF0A20030 0x00080000 0xF0A20034 0x00020003 0xF0A20038 0x00020003
                                    0xF0A2003C 0x0000640A 0xF0A20040 0x00000000

    // lk: scaler: gc
    0x29 0x01 0x00 0x0B 0x00AA 0x03 0xFFFFFFF4
                                    0xF0A20044 0x00000800
 >;
    };
};
