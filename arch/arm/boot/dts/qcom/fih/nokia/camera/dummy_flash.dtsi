
	led_flash2: qcom,camera-led-flash {
		cell-index = <2>;
		//reg = <0x66>;
		//qcom,slave-id = <0x66 0x00 0x0011>;
		compatible = "qcom,camera-led-flash";
		//qcom,flash-type = <1>;
		qcom,cci-master = <0>;
		//qcom,gpio-no-mux = <0>;
		//label = "dummy_bd7710";
		//gpios = <&tlmm 18 0>;
		//qcom,gpio-flash-now = <0>;
		//qcom,gpio-flash-en = <0>;
		//qcom,gpio-req-tbl-num = <0>;
		//qcom,gpio-req-tbl-flags = <0>;
		//qcom,gpio-req-tbl-label = "CAM_FLASH_EN";
		//qcom,max-current = <750>;
		//qcom,max-duration = <1000>;
		status = "ok";
	};

